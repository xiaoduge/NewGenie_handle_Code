#include "display.h"

#include "Relay.h"

#include "Dica.h"

#include <string.h>

#include <stdio.h>

#include <math.h>

#include <stdlib.h>

#include "RTC_Driver.h"

#include "LCD.h"

#include "keyboard.h"

#include "task.h"

#include "IWDG_Driver.h"

#include "font.h"

#include "lib_def.h"

#include "UartCmd.h"

#include "sapp_ex.h"

#include "cminterface.h"

#include "hal_defs.h"

#include "bmp.h"

#include "button.h"

#include "CanCmd.h"

#include "zb.h"


//#define TOC

#define SENSOR_COORD_X (90)
#define SENSOR_COORD_Y (80)

#define SHOW_COORD_X   (20)
#define SHOW_COORD_Y   (LCD_H - 45)

#define SHOW_VERTICAL_SPACE (1)

#define SHOW_TITLE_X_MARGIN 1
#define SHOW_TITLE_Y_MARGIN 1

#define SHOW_TITLE_X   (0)
#define SHOW_TITLE_Y   (0)
#define SHOW_TITLE_W   (LCD_W)
#define SHOW_TITLE_H   (34)

#define SHOW_TITLE_STATE_X   (SHOW_TITLE_X + SHOW_TITLE_X_MARGIN)
#define SHOW_TITLE_STATE_Y   (SHOW_TITLE_Y + SHOW_TITLE_X_MARGIN)
#define SHOW_TITLE_STATE_W   (SHOW_TITLE_W/2 - 2*SHOW_TITLE_X_MARGIN)
#define SHOW_TITLE_STATE_H   (SHOW_TITLE_H - 2*SHOW_TITLE_Y_MARGIN)

#define SHOW_TITLE_STATUS_X   (SHOW_TITLE_STATE_X + SHOW_TITLE_STATE_W + SHOW_TITLE_X_MARGIN)  /* Water quality */
#define SHOW_TITLE_STATUS_Y   (SHOW_TITLE_Y + SHOW_TITLE_X_MARGIN)
#define SHOW_TITLE_STATUS_W   (SHOW_TITLE_W/2 - 2*SHOW_TITLE_X_MARGIN)
#define SHOW_TITLE_STATUS_H   (SHOW_TITLE_H - 2*SHOW_TITLE_Y_MARGIN)

#define SHOW_WATER_QUALITY_X_MARGIN 1
#define SHOW_WATER_QUALITY_Y_MARGIN 1

#define SHOW_WATER_QUALITY_X   (0)  /* Water quality */
#define SHOW_WATER_QUALITY_Y   (SHOW_TITLE_H + SHOW_TITLE_Y + SHOW_VERTICAL_SPACE)
#define SHOW_WATER_QUALITY_W   (LCD_W)
#define SHOW_WATER_QUALITY_H   (65)

#define SHOW_WATER_QUALITY_CONT_X   (SHOW_WATER_QUALITY_X + SHOW_WATER_QUALITY_X_MARGIN)  /* Water quality */
#define SHOW_WATER_QUALITY_CONT_Y   (SHOW_WATER_QUALITY_Y + SHOW_WATER_QUALITY_Y_MARGIN)
#define SHOW_WATER_QUALITY_CONT_W   (SHOW_WATER_QUALITY_W - 2*SHOW_WATER_QUALITY_X_MARGIN)
#define SHOW_WATER_QUALITY_CONT_H   (SHOW_WATER_QUALITY_H - 2*SHOW_WATER_QUALITY_Y_MARGIN)

#define SHOW_WATER_QUALITY_SHOW_X   (MAKE_CXY_CORD(SHOW_WATER_QUALITY_CONT_X,SHOW_WATER_QUALITY_CONT_W))
#define SHOW_WATER_QUALITY_SHOW_Y   (SHOW_WATER_QUALITY_CONT_Y + 37)//(MAKE_CXY_CORD(SHOW_WATER_QUALITY_CONT_Y,SHOW_WATER_QUALITY_CONT_H) + 5)


#define SHOW_WATER_QUALITY_UNIT_X   (SHOW_WATER_QUALITY_CONT_X + 180)
#define SHOW_WATER_QUALITY_UNIT_Y   (SHOW_WATER_QUALITY_CONT_Y + 38)

#define SHOW_HANDLER_TYPE_X   (SHOW_WATER_QUALITY_CONT_X + 7)
#define SHOW_HANDLER_TYPE_Y   (SHOW_WATER_QUALITY_CONT_Y + 24)

#define SHOW_LEVEL_UNIT_X           (225)
#define SHOW_LEVEL_UNIT_Y           (16)

#define SHOW_WATER_PPB_UNIT_X       (70)
#define SHOW_WATER_PPB_UNIT_Y       (115)

#define SHOW_WATER_TEMP_UNIT_X      (220)
#define SHOW_WATER_TEMP_UNIT_Y      (115)

#define SHOW_RTI_X_MARGIN 1
#define SHOW_RTI_Y_MARGIN 1

#define SHOW_RTI_X   (0)    /* Real time info */
#define SHOW_RTI_Y   (SHOW_WATER_QUALITY_Y + SHOW_WATER_QUALITY_H + SHOW_VERTICAL_SPACE + 1)
#define SHOW_RTI_W   (LCD_W)
#define SHOW_RTI_H   (34)

/* for real time info */
#define SHOW_RTI_STATE_X   (SHOW_RTI_X + SHOW_RTI_X_MARGIN)
#define SHOW_RTI_STATE_Y   (SHOW_RTI_Y + SHOW_RTI_Y_MARGIN)
#define SHOW_RTI_STATE_W   (SHOW_RTI_W/2 - SHOW_RTI_Y_MARGIN*2)
#define SHOW_RTI_STATE_H   (SHOW_RTI_H - 2*SHOW_RTI_Y_MARGIN)

#define SHOW_RTI_TEMP_X   (SHOW_RTI_STATE_X+SHOW_RTI_STATE_W + SHOW_RTI_X_MARGIN + 10)
#define SHOW_RTI_TEMP_Y   SHOW_RTI_STATE_Y
#define SHOW_RTI_TEMP_W   SHOW_RTI_STATE_W
#define SHOW_RTI_TEMP_H   SHOW_RTI_STATE_H

#define SHOW_RTI_STATE_SHOW_X   (MAKE_CXY_CORD(SHOW_RTI_STATE_X,SHOW_RTI_STATE_W) - 15)
#define SHOW_RTI_STATE_SHOW_Y   (MAKE_CXY_CORD(SHOW_RTI_STATE_Y,SHOW_RTI_STATE_H))

#define SHOW_RTI_TEMP_SHOW_X   (MAKE_CXY_CORD(SHOW_RTI_TEMP_X,SHOW_RTI_TEMP_W) + 10)
#define SHOW_RTI_TEMP_SHOW_Y   (MAKE_CXY_CORD(SHOW_RTI_TEMP_Y,SHOW_RTI_TEMP_H))

#define SHOW_BUTTON_X   (0)
#define SHOW_BUTTON_Y   (SHOW_RTI_TEMP_Y + SHOW_RTI_TEMP_H + SHOW_VERTICAL_SPACE)
#define SHOW_BUTTON_W   (LCD_W)
#define SHOW_BUTTON_H   (LCD_H - SHOW_BUTTON_Y)

#define SHOW_BUTTON_LEFT_CX   ((0+LCD_W/2)/2)
#define SHOW_BUTTON_LEFT_CY   ((SHOW_BUTTON_Y + LCD_H - 1)/2)
#define SHOW_BUTTON_RIGHT_CX  ((LCD_W/2 + LCD_W -1)/2)
#define SHOW_BUTTON_RIGHT_CY  SHOW_BUTTON_LEFT_CY

#define SHOW_BUTTON_MARGIN    (4)
#define SHOW_BUTTON_DIAMETER  (50)
#define SHOW_BUTTON_BASE_CX   (LCD_W/2)
#define SHOW_BUTTON_BASE_CY   (LCD_H-5-SHOW_BUTTON_DIAMETER/2)

#define SHOW_BUTTON_TWInc_CX   (SHOW_BUTTON_BASE_CX + SHOW_BUTTON_DIAMETER + SHOW_BUTTON_MARGIN)
#define SHOW_BUTTON_TWInc_CY   (SHOW_BUTTON_BASE_CY - SHOW_BUTTON_DIAMETER - SHOW_BUTTON_MARGIN - 10)

#define SHOW_BUTTON_TWDec_CX   (SHOW_BUTTON_BASE_CX - SHOW_BUTTON_DIAMETER + SHOW_BUTTON_MARGIN + 5)
#define SHOW_BUTTON_TWDec_CY   (SHOW_BUTTON_TWInc_CY)

//#define SHOW_BUTTON_TW_CX   (SHOW_BUTTON_BASE_CX)
//#define SHOW_BUTTON_TW_CY   (SHOW_BUTTON_BASE_CY - SHOW_BUTTON_DIAMETER - SHOW_BUTTON_MARGIN)
#define SHOW_BUTTON_TW_CX   (SHOW_BUTTON_BASE_CX - SHOW_BUTTON_DIAMETER + SHOW_BUTTON_MARGIN)
#define SHOW_BUTTON_TW_CY   (SHOW_BUTTON_BASE_CY - 2*(SHOW_BUTTON_DIAMETER + SHOW_BUTTON_MARGIN) - 10)

#define SHOW_BUTTON_SInc_CX   (SHOW_BUTTON_BASE_CX + 5)
#define SHOW_BUTTON_SInc_CY   (SHOW_BUTTON_BASE_CY - 2*(SHOW_BUTTON_DIAMETER + SHOW_BUTTON_MARGIN) - 10)

#define SHOW_BUTTON_SDec_CX   (SHOW_BUTTON_BASE_CX + 5)
#define SHOW_BUTTON_SDec_CY   (SHOW_BUTTON_BASE_CY)

#define SHOW_BUTTON_CIR_CX  (SHOW_BUTTON_BASE_CX + (SHOW_BUTTON_DIAMETER + SHOW_BUTTON_MARGIN))
#define SHOW_BUTTON_CIR_CY  (SHOW_BUTTON_BASE_CY - 2*(SHOW_BUTTON_DIAMETER + SHOW_BUTTON_MARGIN) - 10)

#define SHOW_ARC_X     (SHOW_BUTTON_BASE_CX)
#define SHOW_ARC_Y     (SHOW_BUTTON_BASE_CY - SHOW_BUTTON_DIAMETER)
#define SHOW_ARC_R     (SHOW_BUTTON_DIAMETER/5*3)

#define SHOW_BAR_CX     (SHOW_BUTTON_BASE_CX - SHOW_BUTTON_DIAMETER/5*3 + 5)
#define SHOW_BAR_CY     (SHOW_BUTTON_BASE_CY - SHOW_BUTTON_DIAMETER/5*8 - 5)
#define SHOW_BAR_CW     (70)
#define SHOW_BAR_CH     (15)

#define SHOW_QTWV_X   (MAKE_CXY_CORD(SHOW_BUTTON_X,SHOW_BUTTON_W) - font24.sizeX/2*4 + 1)
#define SHOW_QTWV_Y   (MAKE_CXY_CORD(SHOW_BUTTON_Y,SHOW_BUTTON_H) + font24.sizeY/5*3 - 13)
#define SHOW_QTWV_W   (font24.sizeX*5 + font8.sizeX*1)
#define SHOW_QTWV_H   (font24.sizeY + 3)

#define SHOW_WARNING_CX     (0)
#define SHOW_WARNING_CY     (0)
#define SHOW_WARNING_CW     (LCD_W)
#define SHOW_WARNING_CH     (SHOW_RTI_Y + SHOW_RTI_H)

#define MAKE_RIGHT_CORD(x,w) (x + w - 1)
#define MAKE_BOTTOM_CORD(y,h) (y + h - 1)
#define MAKE_CXY_CORD(c,d) (c+d/2)


#define DISP_QTW_VOLUME_OFFSET (0)

#define TEMP_RANGE_FORMAT     "MAX %02d MIN %02d ℃      "
#define TIME_FORMAT           "%04d-%02d-%02d %02d:%02d:%02d"
#define TIME_FORMAT_SHORT     "%04d-%02d-%02d %02d:%02d"
#define PACK_FORMAT_ENG       "%03dDAYS %04dL"
#define UV_FORMAT_ENG         "%03dDAYS %04dHr"
#define PACK_FORMAT_DUT       "%03dTAGE %04dL"
#define UV_FORMAT_DUT         "%03dTAGE %04dHr"
#define PACK_FORMAT_CHN       "%03d 天  %04d升"
#define UV_FORMAT_CHN         "%03d天 %04d小时"

#define TIME_SET_NUMS (14)
#define TIME_SET_POS {0,1,2,3,5,6,8,9,11,12,14,15,17,18}
#define TEMP_RANGE_SET_NUMS (4)
#define TEMP_RANGE_SET_POS {4,5,11,12}
#define PACK_SET_NUMS (7)
#define PACK_SET_POS {0,1,2,8,9,10,11}
#define UV_SET_NUMS  (7)
#define UV_SET_POS   {0,1,2,8,9,10,11}
#define CELLCONST_SET_NUMS (4)
#define CELLCONST_SET_POS {0,2,3,4}
#define TEMPCONST_SET_NUMS (4)
#define TEMPCONST_SET_POS {0,2,3,4}
#define TIME_RECT_MARGIN (3)

#define DISP_UF_TOP (SHOW_COORD_Y)

#define TOC_MEAS_PERIOD (100)

#define DISP_MAX_DISP_COL_OFFSET (10)

//#define DISP_UF_TEST
#define DISP_ADC_METHOD_CONTINEOUS   0
#define DISP_ADC_METHOD_SIMUTANEOUS  1


#define DISP_ADC_METHOD_TYPE DISP_ADC_METHOD_SIMUTANEOUS


#define DISP_LCD_DORMANT_TIME    (1*60)

#define DISP_ALARM_DURATION_TIME (3*60)


#define UV_PFM_PEROID ((10*60)) // 10 MINUTE

#define DEALTA_OFFSET (curFont->sizeY/2)

#define UNIT_TYPE_0 "MΩ.cm"
#define UNIT_TYPE_1 "μS/cm"

#define HANDLER_TYPE_H "HP"
#define HANDLER_TYPE_U "UP"

#define TANK_VALID (0)

#define LOW_RES  (1000)
#define HIGH_RES (18000)

#define LONGKEY_PRESS_COMM_SECONDS (3)

#define DISP_KEY_WIDTH     (LCD_W)
#define DISP_KEY_HEIGHT    (4is0)

#define DISP_SCREEN_WIDTH  (LCD_W)
#define DISP_SCREEN_HEIGHT (LCD_H - DISP_KEY_HEIGHT)

#define BAR_MAX_LENTH      (10)
#define MAX_TW_VOLUME      (10000)


int isI2 = 0;
int isQtwing = 0;  //QTWING;
uint8_t  isInUsePage = 0;
uint16_t isInUseTimer = 0;
uint8_t isUpdTimer = 1;


typedef enum
{
    CHECK_SHOW_PACK = 0,
    CHECK_SHOW_UV,
    CHECK_SHOW_FILTER,
    CHECK_SHOW_TANK,
    CHECK_SHOW_PRODUCT,
    CHECK_SHOW_PRODUCT1,
    CHECK_SHOW_TEMPERATURE,
    CHECK_SHOW_TEMPERATURE1,
    CHECK_SHOW_NUM,
}CHECK_SHOW_EUNM;

typedef enum
{
   BUTTON_ID_TW = 0,
   BUTTON_ID_CIR ,
   BUTTON_ID_TWInc,
   BUTTON_ID_TWDec,
   BUTTON_ID_SInc, // Increase voltage
   BUTTON_ID_SDec, // Decrease voltage
   BUTTON_ID_NUM,
}BUTTON_ID_ENUM; 

#define toConductivity(value) (((value)<=0.0005?2000:1/(value)))
#define toTempshowvalue(value)(((value)==0?(value):(value)/10))

DISPLAY_STRU gDisplay;

BUTTON *gpBtnCir;
//BUTTON *gpBtnTw;

BUTTON *gpBtnTWInc;
BUTTON *gpBtnTWDec;

BUTTON *gpBtnSpeedInc;
BUTTON *gpBtnSpeedDec;



const uint16_t cordx4cli[5] = {50,LCD_W-50,LCD_W-50,50,LCD_W/2};
const uint16_t cordy4cli[5] = {50,50,LCD_H-50,LCD_H-50,LCD_H/2};

typedef struct
{
    MsgHead msgHead;
    void *para;
}DISP_MSG;

#define DISP_MSG_LENGHT (sizeof(DISP_MSG)-sizeof(MsgHead))



RECT rectTime = {0,0,0,0};

FONT_STRU font24;

FONT_STRU font8;

#ifdef CODEGB_32
FONT_STRU font32;
#endif

#ifdef CODEGB_48
FONT_STRU font48;
#endif

#define MAX_ADC_ACTIONS 4

FONT_STRU *curFont;

static FONT_STRU *oldfont;

const uint8_t bmpcirculate[] = {
0x42,0x4d,0xde,0x04,0x00,0x00,0x00,0x00,0x00,0x00,0x76,0x00,0x00,0x00,0x28,0x00,

0x00,0x00,0x2f,0x00,0x00,0x00,0x2f,0x00,0x00,0x00,0x01,0x00,0x04,0x00,0x00,0x00,
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0x77,0x77,0x77,0x77,0xff,0xff,0xff,0xff,0xff,0xff,0xff,0xff,0xff,0xf0,

};

const uint8_t bmpbtnclick[] = {
0x42,0x4d,0xde,0x04,0x00,0x00,0x00,0x00,0x00,0x00,0x76,0x00,0x00,0x00,0x28,0x00,

0x00,0x00,0x2f,0x00,0x00,0x00,0x2f,0x00,0x00,0x00,0x01,0x00,0x04,0x00,0x00,0x00,
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0x77,0x77,0x77,0x77,0xff,0xff,0xff,0xff,0xff,0xff,0xff,0xff,0xff,0xf0,
};

const uint8_t bmptakewater[] = {
0x42,0x4d,0xde,0x04,0x00,0x00,0x00,0x00,0x00,0x00,0x76,0x00,0x00,0x00,0x28,0x00,

0x00,0x00,0x2f,0x00,0x00,0x00,0x2f,0x00,0x00,0x00,0x01,0x00,0x04,0x00,0x00,0x00,
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0x77,0x77,0x77,0x77,0xff,0xff,0xff,0xff,0xff,0xff,0xff,0xff,0xff,0xf0,
};

const uint8_t bmpTWInc[] = {
0x42,0x4d,0xde,0x04,0x00,0x00,0x00,0x00,0x00,0x00,0x76,0x00,0x00,0x00,0x28,0x00,

0x00,0x00,0x2f,0x00,0x00,0x00,0x2f,0x00,0x00,0x00,0x01,0x00,0x04,0x00,0x00,0x00,
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0x77,0x77,0x77,0x77,0xff,0xff,0xff,0xff,0xff,0xff,0xff,0xff,0xff,0xf0,
};

const uint8_t bmpTWDec[] = {
0x42,0x4d,0xde,0x04,0x00,0x00,0x00,0x00,0x00,0x00,0x76,0x00,0x00,0x00,0x28,0x00,

0x00,0x00,0x2f,0x00,0x00,0x00,0x2f,0x00,0x00,0x00,0x01,0x00,0x04,0x00,0x00,0x00,
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0x77,0x77,0x77,0x77,0xff,0xff,0xff,0xff,0xff,0xff,0xff,0xff,0xff,0xf0,

};

const uint8_t bmpSpeedInc[] = {
0x42,0x4d,0xde,0x04,0x00,0x00,0x00,0x00,0x00,0x00,0x76,0x00,0x00,0x00,0x28,0x00,

0x00,0x00,0x2f,0x00,0x00,0x00,0x2f,0x00,0x00,0x00,0x01,0x00,0x04,0x00,0x00,0x00,
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0x77,0x77,0x77,0x77,0xff,0xff,0xff,0xff,0xff,0xff,0xff,0xff,0xff,0xf0,

};

const uint8_t bmpSpeedDec[] = {
0x42,0x4d,0xde,0x04,0x00,0x00,0x00,0x00,0x00,0x00,0x76,0x00,0x00,0x00,0x28,0x00,

0x00,0x00,0x2f,0x00,0x00,0x00,0x2f,0x00,0x00,0x00,0x01,0x00,0x04,0x00,0x00,0x00,
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0x77,0x77,0x77,0x77,0xff,0xff,0xff,0xff,0xff,0xff,0xff,0xff,0xff,0xf0,
};

const uint8_t bmpprogressbar[] = {
0x42,0x4d,0x9e,0x00,0x00,0x00,0x00,0x00,0x00,0x00,0x76,0x00,0x00,0x00,0x28,0x00,

0x00,0x00,0x05,0x00,0x00,0x00,0x0a,0x00,0x00,0x00,0x01,0x00,0x04,0x00,0x00,0x00,
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0x70,0x00,0x77,0x77,0x70,0x00,0x77,0x77,0x70,0x00,0x77,0x77,0x70,0x00,
};

const uint8_t bmpprogressbarback[] = {
0x42,0x4d,0x36,0x02,0x00,0x00,0x00,0x00,0x00,0x00,0x76,0x00,0x00,0x00,0x28,0x00,

0x00,0x00,0x40,0x00,0x00,0x00,0x0e,0x00,0x00,0x00,0x01,0x00,0x04,0x00,0x00,0x00,
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0x77,0x77,0x77,0x77,0x77,0x77,
};

#define DISPLAY_ADC_CHECK_UNIT (100) // 100MS

#define DECREASE_VALUE(value) do {(value) = ((value) >=DISPLAY_ADC_CHECK_UNIT) ? (value)-DISPLAY_ADC_CHECK_UNIT : 0;}while(0)


void Disp_Prepare4Qtw(void);

void Disp_Prepare4Circulation(int bLocal);

void Disp_Update4State(uint8_t ucState);

void Disp_BtnClicked(void *para);

void Disp_EnableScreenSaver(int bEnable);

void Disp_ProcessAlarmInd(uint8_t ucInvalidate);


#define DEALTA 5

void Disp_PutCross(int x, int y,u16 color)
{
    LCD_DrawLine(x-DEALTA,y-1,x+DEALTA,y-1,color);
    LCD_DrawLine(x-DEALTA,y,  x+DEALTA,y,  color);
    LCD_DrawLine(x-DEALTA,y+1,x+DEALTA,y+1,color);

    LCD_DrawLine(x-1,y-DEALTA,x-1,y+DEALTA,color);
    LCD_DrawLine(x  ,y-DEALTA,x  ,y+DEALTA,color);
    LCD_DrawLine(x+1,y-DEALTA,x+1,y+DEALTA,color);
}

void Disp_ClearCross(int x, int y,u16 color)
{
    LCD_ClearRect(x-DEALTA,y-DEALTA,x+DEALTA,y+DEALTA,color);

}

void Disp_SelectFont(FONT_STRU *ft)
{
    if (curFont != ft)
    {
       oldfont = curFont;
       curFont = ft;
    }
}

void Disp_Invalidate(void);

#define is_digit(ch)  ((ch>='0' && ch<='9'))
  
#define is_space(ch)  ((ch==' ') || (ch=='\t')) 
 
void Disp_atof(char *s,UINT32 *value,UINT32 delimit)  
{  
    int i,sign;  
    UINT32 power;
    for(i=0;is_space(s[i]);i++);
    sign = (s[i]=='-') ? -1 : 1;  
    if(s[i] == '-' || s[i] == '+')
        i++;  
    for(*value = 0; is_digit(s[i]); i++)
        *value = *value*10+(s[i]-'0');  
    if(s[i] == '.')  
        i++;  
    for(power = 1; is_digit(s[i]); i++) 
    {  
        *value = *value*10+(s[i]-'0');  
        power *= 10;  
    }  
        
      *value *= sign;

     if (power < 1000)
     {
         *value *= (1000/power);
     }
     else
     {
         *value /= (power/1000);
     }
    
}  


/**
  * @brief  Configures valves according to state.
  * @param  state: working state.
  *   This parameter can be one of following parameters:    
  *     @arg DISPLAY_STATE_ENUM
  * @retval None
  */
void Disp_ValveCtrl(STATE_STRU *state)
{
    switch(state->ucMain)
    {
    default:
        RelayLogicCtrl(RELAY_VALVE_1,FALSE);
        gDisplay.Fm.ulBgnFm      = INVALID_CONFIG_VALUE_LONG;
        gDisplay.Fm.ulCurFm      = INVALID_CONFIG_VALUE_LONG;
        break;
    case DISPLAY_STATE_NORMAL_TAKING_WATER:
    case DISPLAY_STATE_QUANTITY_TAKING_WATER:
        /* do nothing */
        break;
    case DISPLAY_STATE_DECOMPRESSION:
        RelayLogicCtrl(RELAY_VALVE_1,TRUE);
        break;
    }

}

void Disp_ClearScreen(u16 Color)
{
    LCD_ClearRect(0,0,LCD_W - 1,LCD_H - 1,Color);
}

void Disp_ClearInfoScreen(u16 Color)
{
    LCD_ClearRect(0,0,LCD_W - 1,MAKE_BOTTOM_CORD(0,SHOW_WARNING_CY+SHOW_WARNING_CH) - 1,Color);
}

void Disp_ClearButtonScreen(u16 Color)
{
    LCD_ClearRect(0,MAKE_BOTTOM_CORD(SHOW_WARNING_CY,SHOW_WARNING_CH)+1,LCD_W - 1,LCD_H - 1,Color);
}


void Disp_KeyRegion(void)
{
   // LCD_ClearRect(0, DISP_SCREEN_HEIGHT, DISP_SCREEN_WIDTH - 1, LCD_H - 1, WHITE);
}

void Disp_Select_Sensor(int Mask)
{
}

void Disp_Int2floatFormat(int value,int integer,int decimal,char *buf)
{
    int divid = 1;
    int len = 0;
    int value1,value2;
    static uint8_t tmpBuf[32];

    for (value1 = 0; value1 < decimal; value1++)
    {
        divid *= 10;
    }

    value1 = value/divid; // get integer part

    value2 = value%divid;  // get decimal part

    
    do{
        tmpBuf[len++] = value1%10 + '0';
        value1 /= 10;
    }while(value1 > 0);
    
    for (value1 = len; value1 < integer; value1++)
    {
        tmpBuf[len++] = ' ';
    }

    // now reverse
    for (value1 = 0; value1 < len; value1++)
    {
        buf[value1] = tmpBuf[len - 1 - value1];
    }

    buf[len++] = '.';

    for (value = 0; value < decimal; value++)
    {
        divid /= 10;
        buf[len++] = '0' + (value2/divid);
        value2 %= divid;
    }
    buf[len] = 0;   

}


void Disp_Int2float(int value,char *buf)
{
    Disp_Int2floatFormat(value,2,1,buf);
}

void Disp_Int2float1(int value,char *buf)
{
    Disp_Int2floatFormat(value,1,3,buf);
}

void Disp_report(void *para)
{
   Message *Msg;
   Msg = MessageAlloc(PID_SELF,DISP_MSG_LENGHT);

   if (Msg)
   {
       DISP_MSG *dmsg = (DISP_MSG *)Msg;
       dmsg->msgHead.nMsgType = SELF_MSG_CODE_USER_DISP;
       dmsg->para = para;
       MessageSend(Msg);
   }
}

void Disp_CleanTail(int xoff,int yoff,char *text,uint16_t usBkColor)
{
    // clean tail
    xoff += curFont->sizeX*strlen((char *)text);

    LCD_Fill(xoff,yoff,LCD_W - 1,yoff+curFont->sizeY,usBkColor);

}

void Draw_Speed_Progress_Bar()
{
    int ucloop;
    uint16_t usLeft;
    uint16_t usTop;

    if(gDisplay.bit1ScreenSaver)
	{
		return;
	}

   //LCD_ClearRect(SHOW_BAR_CX,SHOW_BAR_CY,MAKE_RIGHT_CORD(SHOW_BAR_CX,SHOW_BAR_CW),MAKE_BOTTOM_CORD(SHOW_BAR_CY,SHOW_BAR_CH),gDisplay.usBackColor);
    DrawBitmap(bmpprogressbarback,SHOW_BAR_CX,SHOW_BAR_CY,LCD_DrawPoint);
    DrawBitmap(bmpprogressbar,SHOW_BAR_CX + 2,SHOW_BAR_CY + 2,LCD_DrawPoint);

    gDisplay.ucQtwSpeed > 10 ? gDisplay.ucQtwSpeed = 10 : gDisplay.ucQtwSpeed;
   
    for(ucloop = 0;ucloop < gDisplay.ucQtwSpeed;ucloop++)
    {
		usLeft = SHOW_BAR_CX + 2 + 6*ucloop;
        usTop  = SHOW_BAR_CY + 2;
        DrawBitmap(bmpprogressbar,usLeft,usTop,LCD_DrawPoint);
    }

}

void Disp_ShowTitle(char *strState)//,char *strInfo)
{
    int xoff;
    int yoff;
    uint8_t ucTitleLen = strlen(strState);

	if(gDisplay.bit1ScreenSaver)
	{
		return;
	}
    
    
	LCD_DrawRectangle(SHOW_TITLE_X,SHOW_TITLE_Y,MAKE_RIGHT_CORD(SHOW_TITLE_X,SHOW_TITLE_W),MAKE_BOTTOM_CORD(SHOW_TITLE_Y,SHOW_TITLE_H),gDisplay.usForColor);

    xoff = SHOW_HANDLER_TYPE_X;
    
    yoff = MAKE_CXY_CORD(SHOW_TITLE_STATE_Y,SHOW_TITLE_STATE_H) - curFont->sizeY/2 ;
    
    curFont->DrawText(xoff,yoff,(u8 *)strState,gDisplay.usForColor,gDisplay.usBackColor);

    {
        int iFiller;
        xoff += curFont->sizeX * ucTitleLen;
        for (iFiller = ucTitleLen; iFiller < gDisplay.ucCurTitleLen;iFiller++)
        {
            curFont->DrawChar(xoff,yoff,' ',gDisplay.usForColor,gDisplay.usBackColor);
            xoff += curFont->sizeX;
        }
    }
    gDisplay.ucCurTitleLen = ucTitleLen;
}

void Disp_UpdateTitle4Status(int iWaterQuantity)
{
    int xoff;
    int yoff;

    char buf[20];

    Disp_Int2float(iWaterQuantity/100,buf); // ml->litre

	LCD_ClearRect(SHOW_TITLE_STATUS_X,SHOW_TITLE_STATUS_Y,MAKE_RIGHT_CORD(SHOW_TITLE_STATUS_X,SHOW_TITLE_STATUS_W),MAKE_BOTTOM_CORD(SHOW_TITLE_STATUS_Y,SHOW_TITLE_STATUS_H),gDisplay.usBackColor);

    xoff = MAKE_CXY_CORD(SHOW_TITLE_STATUS_X,SHOW_TITLE_STATUS_W) - curFont->sizeX/2*(strlen(buf));
    
    yoff = MAKE_CXY_CORD(SHOW_TITLE_STATUS_Y,SHOW_TITLE_STATUS_H) - curFont->sizeY/2 ;
    
    curFont->DrawText(xoff,yoff,(u8 *)buf,gDisplay.usForColor,gDisplay.usBackColor);

}

void Disp_UpdateWaterQuality(float fValue)
{
    int xoff;
    int yoff;

    char buf[32];

	if(gDisplay.bit1ScreenSaver) //屏保时不刷新水质值
	{
		return;
	}

    Disp_SelectFont(&font8);

    xoff = SHOW_WATER_QUALITY_UNIT_X;
    
    yoff = SHOW_WATER_QUALITY_UNIT_Y;
	if(isI2 == 1)
	{
		curFont->DrawText(xoff,yoff,(uint8 *)(UNIT_TYPE_1),gDisplay.usForColor,gDisplay.usBackColor);
	}
	else
	{
		curFont->DrawText(xoff,yoff,(uint8 *)(gDisplay.ucUnit == 1 ? UNIT_TYPE_1 : UNIT_TYPE_0),gDisplay.usForColor,gDisplay.usBackColor);
	}
    
    //curFont->DrawText(xoff,yoff,(uint8 *)(gDisplay.ucUnit == 1 ? UNIT_TYPE_1 : UNIT_TYPE_0),gDisplay.usForColor,gDisplay.usBackColor);

    Disp_SelectFont(oldfont);
    
    Disp_SelectFont(&font48);

    //VOS_LOG(VOS_LOG_DEBUG,"Disp_UpdateWaterQuality %d&%f",(int)fValue*10,fValue);
    
    if (gDisplay.ucUnit && (1 != isI2))
    {
        fValue = toConductivity(fValue);
        if(fValue < 0.055)
        {
            fValue = 0.055;
        }

        if (fValue < 1)
        {
            Disp_Int2floatFormat((fValue*1000),1,3,buf);
        }
        else
        {
            Disp_Int2floatFormat((fValue*1000),3,3,buf);
        }
        //sprintf(buf,"%.3f",fValue);
        buf[5] = 0;
    }
    else
    {
        //sprintf(buf,"%.1f",fValue);
        Disp_Int2float((int)((fValue + 0.05)*10),buf);
        buf[4] = 0;
    }

    xoff -= (curFont->sizeX*(strlen(buf)) + 10);
    
    yoff = SHOW_WATER_QUALITY_SHOW_Y - curFont->sizeY/2 ;

    if(4 >= strlen(buf))LCD_ClearRect(SHOW_WATER_QUALITY_X + 40,SHOW_WATER_QUALITY_Y+2,SHOW_WATER_QUALITY_UNIT_X-2,SHOW_WATER_QUALITY_UNIT_Y+23,gDisplay.usBackColor);
    
    curFont->DrawText(xoff,yoff,(u8 *)buf,gDisplay.usForColor,gDisplay.usBackColor);

    Disp_SelectFont(oldfont);

}

void Disp_ShowWaterQuality(float fValue)
{   
    int xoff;
    int yoff;
    
	LCD_DrawRectangle(SHOW_WATER_QUALITY_X,SHOW_WATER_QUALITY_Y,MAKE_RIGHT_CORD(SHOW_WATER_QUALITY_X,SHOW_WATER_QUALITY_W),MAKE_BOTTOM_CORD(SHOW_WATER_QUALITY_Y,SHOW_WATER_QUALITY_H),gDisplay.usForColor);

    xoff = SHOW_HANDLER_TYPE_X;
    
    yoff = SHOW_HANDLER_TYPE_Y;
    
    if (APP_DEV_HS_SUB_HYPER == gDisplay.ucDevType)
    {
        curFont->DrawText(xoff,yoff,(uint8 *)(HANDLER_TYPE_U),gDisplay.usForColor,gDisplay.usBackColor);
    }
    else
    {
        curFont->DrawText(xoff,yoff,(uint8 *)(HANDLER_TYPE_H),gDisplay.usForColor,gDisplay.usBackColor);
    }

    Disp_UpdateWaterQuality(fValue);
}


void Disp_UpdateRti4State(float fPpb)
{
    int xoff;
	
    int yoff;
    char buf[32];

    gDisplay.fWaterPPB = fPpb;

	if(gDisplay.bit1ScreenSaver)
	{
		return;
	}
    
    if ((0 != gDisplay.ucHaveTOC)
		&& ( APP_DEV_HS_SUB_HYPER == gDisplay.ucDevType))
    {
        //sprintf(buf,"%.1f",gDisplay.fWaterPPB);

#if 0
#ifdef Decimal1
        Disp_Int2float((int)((gDisplay.fWaterPPB)*10),buf);
#else
		int tmpPPB = (int)(gDisplay.fWaterPPB + 0.5);
		sprintf(buf, "%d", tmpPPB);
#endif
#endif
		if(gDisplay.fWaterPPB < 10) //TOC灏忎簬10锛屾樉绀轰竴浣嶅皬鏁?
		{
			 Disp_Int2floatFormat(gDisplay.fWaterPPB * 10 + 0.5, 2, 1, buf);
		}
		else
		{
			int tmpPPB = (int)(gDisplay.fWaterPPB + 0.5);
			sprintf(buf, "%d", tmpPPB);
		}
        //xoff = SHOW_RTI_STATE_SHOW_X - curFont->sizeX/2*3;
        xoff = SHOW_WATER_PPB_UNIT_X - curFont->sizeX * (strlen(buf)) - 8;
        
        yoff = SHOW_RTI_STATE_SHOW_Y - curFont->sizeY/2 ;
        
        curFont->DrawText(xoff,yoff,(u8 *)buf,gDisplay.usForColor,gDisplay.usBackColor);
        
        Disp_SelectFont(&font8);
        
        curFont->DrawText(SHOW_WATER_PPB_UNIT_X,SHOW_WATER_PPB_UNIT_Y,"ppb",gDisplay.usForColor,gDisplay.usBackColor);
        
        Disp_SelectFont(oldfont);
    }

    //printf("Disp_UpdateRti4State ucHaveTOC %d \r\n",gDisplay.ucHaveTOC);
    
}

void Disp_UpdateRti4Temp(int iTemp)
{
    int xoff;
    int yoff;
    char buf[20];


	if(gDisplay.bit1ScreenSaver)
	{
		return;
	}


    //sprintf(buf,"%d",toTempshowvalue(gDisplay.iTemperature));
    
    Disp_Int2floatFormat(gDisplay.iTemperature,2,1,buf);

    xoff = SHOW_WATER_TEMP_UNIT_X - curFont->sizeX * (strlen(buf)) - 8;
    
    yoff = SHOW_RTI_TEMP_SHOW_Y - curFont->sizeY/2 ;
    
    curFont->DrawText(xoff,yoff,(u8 *)buf,gDisplay.usForColor,gDisplay.usBackColor);

    Disp_SelectFont(&font8);

    curFont->DrawText(SHOW_WATER_TEMP_UNIT_X,SHOW_WATER_TEMP_UNIT_Y,"℃",gDisplay.usForColor,gDisplay.usBackColor);

    Disp_SelectFont(oldfont);
    
}

void Disp_ShowRti(float fPpb,int iTemp)
{
	if(gDisplay.bit1ScreenSaver)
	{
		return;
	}
	
    LCD_DrawRectangle(SHOW_RTI_X,SHOW_RTI_Y,MAKE_RIGHT_CORD(SHOW_RTI_X,SHOW_RTI_W),MAKE_BOTTOM_CORD(SHOW_RTI_Y,SHOW_RTI_H),gDisplay.usForColor);

    Disp_UpdateRti4State(fPpb);
    Disp_UpdateRti4Temp(iTemp);
}

void Disp_LiquidLevelUpdatePage(void)
{  
    int xoff,yoff;
	
    char buf[20];
	
	if(gDisplay.bit1ScreenSaver)
	{
		return;
	}

	if(0 < gDisplay.ucLiquidLevel)
	{
		sprintf(buf,"%d",(gDisplay.ucLiquidLevel >= 100 ? 100 : gDisplay.ucLiquidLevel));
            
	    //xoff = MAKE_CXY_CORD(SHOW_TITLE_STATUS_X,SHOW_TITLE_STATUS_W) - curFont->sizeX/2;
	    xoff = SHOW_LEVEL_UNIT_X - curFont->sizeX * (strlen(buf)) - 3;
	    
	    yoff = MAKE_CXY_CORD(SHOW_TITLE_STATUS_Y,SHOW_TITLE_STATUS_H) - curFont->sizeY/2 ;
	    
	    curFont->DrawText(xoff,yoff,(u8 *)buf,gDisplay.usForColor,gDisplay.usBackColor);

	    Disp_SelectFont(&font8);

	    curFont->DrawText(SHOW_LEVEL_UNIT_X ,SHOW_LEVEL_UNIT_Y,"%",gDisplay.usForColor,gDisplay.usBackColor);

	    Disp_SelectFont(oldfont);
	}
	else
	{
		LCD_ClearRect(150,3,235,30,gDisplay.usBackColor);
	}
}

void Disp_ShowButtons(BOOL bShow)
{
	if(gDisplay.bit1ScreenSaver)
	{
		return;
	}
	
    if (gDisplay.bit1InvalidBtns) 
    {
        Disp_ClearButtonScreen(WHITE);
        gDisplay.bit1InvalidBtns = 0;
    }

    BtnShow(gpBtnTWInc,bShow);
    BtnShow(gpBtnTWDec,bShow);
    
    BtnShow(gpBtnCir,bShow);
    //BtnShow(gpBtnTw,bShow);

    BtnShow(gpBtnSpeedInc,bShow);
    BtnShow(gpBtnSpeedDec,bShow);
}

void Disp_ShowInfo(char *title)
{
	if(gDisplay.bit1ScreenSaver)
	{
		return;
	}

    if (gDisplay.bit1InvalidScreen)
    {
        Disp_ClearInfoScreen(gDisplay.usBackColor);
        gDisplay.bit1InvalidScreen = 0;
    }

    Disp_ShowTitle(title);
    
    Disp_LiquidLevelUpdatePage();
    
    Disp_ShowWaterQuality(gDisplay.fWaterQuality);
    
    Disp_ShowRti(gDisplay.fWaterPPB,gDisplay.iTemperature);
    
    Draw_Speed_Progress_Bar();
}



void Disp_WorkState(int xoff, int yoff,char *text)
{

    if (0xFF == xoff 
      && 0XFF == yoff)
    {
        xoff = LCD_W/2 - curFont->sizeX/2*(strlen(text));
        
        yoff = LCD_H/2 - curFont->sizeY/2 - DEALTA_OFFSET;
    }
    
    curFont->DrawText(xoff,yoff,(u8 *)text,gDisplay.usForColor,gDisplay.usBackColor);

}

void Disp_Move2DstState(void)
{
    Disp_ValveCtrl(&gDisplay.TgtState);
}

void Disp_Move2DstPage(void)
{
#if (IWDG_SUPPORT > 0)
    IWDG_Feed();  
#endif

    gDisplay.curPage = gDisplay.tgtPage;

    gDisplay.tgtPage.ucMain = DISPLAY_PAGE_BUTT;
    gDisplay.tgtPage.ucSub  = DISPLAY_SUB_PAGE_BUTT;
}

void Disp_ReadQtwVolume(void)
{
    int ret = RTC_ReadBackup((uint8_t *)&gDisplay.usQtwWq,DISP_QTW_VOLUME_OFFSET,sizeof(uint16_t));

    if (ret == 0)
    {
        VOS_LOG(VOS_LOG_ERROR,"read qtw fail");
    }
    
    if (INVALID_CONFIG_VALUE == gDisplay.usQtwWq)
    {
        gDisplay.usQtwWq = 0;
    }

}

void Disp_WriteQtwVolume(void)
{
    int ret = RTC_WriteBackup((uint8_t *)&gDisplay.usQtwWq,DISP_QTW_VOLUME_OFFSET,sizeof(uint16_t));

    if (ret == 0)
    {
       VOS_LOG(VOS_LOG_ERROR,"write qtw fail");
    }
}

void Disp_SaveQtwVolume(void)
{
    uint16_t ustemp = gDisplay.usQtwWq;
    Disp_ReadQtwVolume();
    if (ustemp != gDisplay.usQtwWq)
    {
        gDisplay.usQtwWq = ustemp;
        Disp_WriteQtwVolume();
    }
}

void Disp_ReadQtwSpeed(void)
{
    int ret = RTC_ReadBackup((uint8_t *)&gDisplay.ucQtwSpeed,DISP_QTW_VOLUME_OFFSET,sizeof(uint16_t));

    if (ret == 0)
    {
        VOS_LOG(VOS_LOG_ERROR,"read qtwspeed fail");
    }
    
    if (INVALID_CONFIG_VALUE == gDisplay.ucQtwSpeed)
    {
        gDisplay.ucQtwSpeed = 0;
    }

}

void Disp_WriteQtwSpeed(void)
{
    int ret = RTC_WriteBackup((uint8_t *)&gDisplay.ucQtwSpeed,DISP_QTW_VOLUME_OFFSET,sizeof(uint16_t));

    if (ret == 0)
    {
       VOS_LOG(VOS_LOG_ERROR,"write qtwspeed fail");
    }
}

void Disp_SaveQtwSpeed(void)
{
    uint16_t ustemp = gDisplay.ucQtwSpeed;
    Disp_ReadQtwSpeed();
    if (ustemp != gDisplay.ucQtwSpeed)
    {
        gDisplay.ucQtwSpeed = ustemp;
        Disp_WriteQtwSpeed();
    }
}

void Disp_ShowTime(void)
{
#ifdef SHOW_TIME    
    LCD_DrawRectangle(rectTime.left,rectTime.top,rectTime.right,rectTime.bottom,MAGENTA);

    sprintf((char *)Config_buff,TIME_FORMAT_SHORT,timer.w_year,timer.w_month,timer.w_date,timer.hour,timer.min);

    curFont->DrawText(rectTime.left + TIME_RECT_MARGIN,rectTime.top + TIME_RECT_MARGIN,(char *)Config_buff,BLACK,WHITE);
#endif    
}

void Disp_ShowEmptyTank(int xoff, int yoff)
{
    char *text;
    isInUsePage = 0;
    switch(gDisplay.ucLan)
    {
    default:
    case APP_LAN_ENG:
        text = "Empty Tank";
        break;
    case APP_LAN_GER:
        text = "Empty Tank";
        break;
    case APP_LAN_CHN:
        text = "水箱空";
        break;
    }
   
    Disp_WorkState(xoff,yoff,text);
}

uint8_t Disp_GetTrxIndex(void)
{
    uint8_t ucTrxIndex = APP_TRX_CAN;
   
    if (gDisplay.ucTrxMap & (1 << APP_TRX_CAN))
    {
        ucTrxIndex = APP_TRX_CAN;
    }
    else if (gDisplay.ucTrxMap & (1 << APP_TRX_ZIGBEE))
    {
        ucTrxIndex = APP_TRX_ZIGBEE;
    }

    return ucTrxIndex;

}

uint8_t Disp_SndTakingWaterMsg(int ucAction,uint32_t ulVolumn)
{
    uint8_t buf[32];
    APP_PACKET_HO_STRU *pTw = (APP_PACKET_HO_STRU *)buf;

    uint8_t ucTrxIndex = Disp_GetTrxIndex();

    APP_PACKET_HO_QTW_REQ_STRU     *pLoad = (APP_PACKET_HO_QTW_REQ_STRU *)(pTw->aucData);
    pTw->hdr.ucLen     = 1 + sizeof(APP_PACKET_HO_QTW_REQ_STRU);
    pTw->hdr.ucTransId = 0;
    pTw->hdr.ucDevType = APP_DEV_TYPE_HAND_SET;
    pTw->hdr.ucMsgType = APP_PACKET_HAND_OPERATION;
    pTw->ucOpsType     = APP_PACKET_HO_QTW;

    pLoad->ucAction    = ucAction;
    pLoad->ulVolumn    = ulVolumn ;

    return CanCcbSndHandleOperationMsg(Trx2CanCcbIndex(ucTrxIndex),buf,APP_PROTOL_HEADER_LEN + pTw->hdr.ucLen);
}

uint8_t Disp_SndDecPressureMsg(int ucAction,int iOpreatType)
{
    uint8_t buf[32];
    APP_PACKET_HO_STRU *pTw = (APP_PACKET_HO_STRU *)buf;

    uint8_t ucTrxIndex = Disp_GetTrxIndex();

    APP_PACKET_HO_SYSTEMTEST_REQ_STRU     *pLoad = (APP_PACKET_HO_SYSTEMTEST_REQ_STRU *)(pTw->aucData);
    pTw->hdr.ucLen     = 1 + sizeof(APP_PACKET_HO_SYSTEMTEST_REQ_STRU);
    pTw->hdr.ucTransId = 0;
    pTw->hdr.ucDevType = APP_DEV_TYPE_MAIN_CTRL;
    pTw->hdr.ucMsgType = APP_PACKET_HAND_OPERATION;
    pTw->ucOpsType     = APP_PACKET_HO_SYSTEM_TEST;

    pLoad->ucAction    = ucAction;
    pLoad->ucType      = iOpreatType;

    return CanCcbSndHandleOperationMsg(Trx2CanCcbIndex(ucTrxIndex),buf,APP_PROTOL_HEADER_LEN + pTw->hdr.ucLen);
}

uint8_t Disp_SndSystemTestRspMsg(uint8_t ucTrxIndex,APP_PACKET_HO_SYSTEMTEST_REQ_STRU *pReq)
{
    uint8_t buf[32];
    APP_PACKET_HO_STRU *pTwt = (APP_PACKET_HO_STRU *)buf;

    APP_PACKET_HO_SYSTEMTEST_RSP_STRU     *pLoad = (APP_PACKET_HO_SYSTEMTEST_RSP_STRU *)(pTwt->aucData);
    pTwt->hdr.ucLen     = 1 + sizeof(APP_PACKET_HO_SYSTEMTEST_RSP_STRU);
    pTwt->hdr.ucTransId = 0;
    pTwt->hdr.ucDevType = APP_DEV_TYPE_HAND_SET;
    pTwt->hdr.ucMsgType = APP_PACKET_HAND_OPERATION|0X80;
    pTwt->ucOpsType     = APP_PACKET_HO_SYSTEM_TEST;
    
    pLoad->ucAction     = pReq->ucAction;
    pLoad->ucType       = pReq->ucType;
    pLoad->ucResult     = 0 ;

    return CanCcbSndHandleOperationMsg(Trx2CanCcbIndex(ucTrxIndex),buf,APP_PROTOL_HEADER_LEN + pTwt->hdr.ucLen);
}


uint8_t Disp_SndCirMsg(int ucAction)
{
     uint8_t buf[32];
     APP_PACKET_HO_STRU *pCir = (APP_PACKET_HO_STRU *)buf;

     APP_PACKET_HO_CIR_REQ_STRU     *pLoad = (APP_PACKET_HO_CIR_REQ_STRU *)(pCir->aucData);

     uint8_t ucTrxIndex = Disp_GetTrxIndex();

     pCir->hdr.ucLen     = 1 + sizeof(APP_PACKET_HO_CIR_REQ_STRU);
     pCir->hdr.ucTransId = 0;
     pCir->hdr.ucDevType = APP_DEV_TYPE_HAND_SET;
     pCir->hdr.ucMsgType = APP_PACKET_HAND_OPERATION;
     pCir->ucOpsType     = APP_PACKET_HO_CIR;
     pLoad->ucAction     = ucAction;

     return CanCcbSndHandleOperationMsg(Trx2CanCcbIndex(ucTrxIndex),buf,APP_PROTOL_HEADER_LEN + pCir->hdr.ucLen);
}

uint8_t Disp_SndTwSpeedMsg(int ucAction)
{
    uint8_t buf[32];
    APP_PACKET_HO_STRU *pSpd = (APP_PACKET_HO_STRU *)buf;

    APP_PACKET_HO_SPEED_REQ_STRU     *pLoad = (APP_PACKET_HO_SPEED_REQ_STRU *)(pSpd->aucData);
   
    uint8_t ucTrxIndex = Disp_GetTrxIndex();
    
    pSpd->hdr.ucLen     = 1 + sizeof(APP_PACKET_HO_SPEED_REQ_STRU);
    pSpd->hdr.ucTransId = 0;
    pSpd->hdr.ucDevType = APP_DEV_TYPE_HAND_SET;
    pSpd->hdr.ucMsgType = APP_PACKET_HAND_OPERATION;
    pSpd->ucOpsType     = APP_PACKET_HO_SPEED;

    pLoad->ucAction    = ucAction;

    return CanCcbSndHandleOperationMsg(Trx2CanCcbIndex(ucTrxIndex),buf,APP_PROTOL_HEADER_LEN + pSpd->hdr.ucLen);
}


void Disp_DisplayIdlePage(void)
{
    char *text;
    
    gDisplay.ucOperState = APP_PACKET_HS_STATE_IDLE;
    isInUsePage = 0;

    // display text info
    switch(gDisplay.ucLan)
    {
    default:
    case APP_LAN_ENG:
        text = "Standby";
        break;
    case APP_LAN_GER:
        text = "Standby";
        break;
    case APP_LAN_CHN:
        text = "待机   ";
        break;
    }
  
    Disp_ShowInfo(text);
    Disp_ShowButtons(TRUE);
}

//2019.3.5 add
void Disp_DisplayInUsePage(void)
{
    char *text;

    gDisplay.ucOperState = APP_PACKET_HS_STATE_RUN;
    isInUsePage = 1;

    // display text info
    switch(gDisplay.ucLan)
    {
    default:
    case APP_LAN_ENG:
        text = "In Use ";
        break;
    case APP_LAN_GER:
        text = "In Use ";
        break;
    case APP_LAN_CHN:
        text = "使用中 ";
        break;
    }
 
    Disp_ShowInfo(text);
    Disp_ShowButtons(TRUE);

}


//2019.3.5 add
void Disp_DisplayWaitPage(void)
{
    char *text;

    gDisplay.ucOperState = APP_PACKET_HS_STATE_WAIT;
    isInUsePage = 0;

    // display text info
    switch(gDisplay.ucLan)
    {
    default:
    case APP_LAN_ENG:
        text = "Waiting";
        break;
    case APP_LAN_GER:
        text = "Waiting";
        break;
    case APP_LAN_CHN:
        text = "稍等   ";
        break;
    }
 
    Disp_ShowInfo(text);
    Disp_ShowButtons(TRUE);

}

void Disp_DisplayRunPage(void)
{
    char *text;

    gDisplay.ucOperState = APP_PACKET_HS_STATE_RUN;
    isInUsePage = 0;

    // display text info
    switch(gDisplay.ucLan)
    {
    default:
    case APP_LAN_ENG:
        text = "Ready  ";
        break;
    case APP_LAN_GER:
        text = "Ready  ";
        break;
    case APP_LAN_CHN:
        text = "就绪   ";
        break;
    }
 
    Disp_ShowInfo(text);
    Disp_ShowButtons(TRUE);
   
}

void Disp_UpdateIdlePage(void)
{
}

void Disp_Move2Idle(void)
{
    Disp_Move2DstPage();
    
    Disp_Move2DstState();
    
    Disp_DisplayIdlePage();
}

void Disp_PrepareMove2Idle(void)
{
    // transer to idle
    gDisplay.tgtPage.ucMain = DISPLAY_PAGE_IDLE;
    gDisplay.tgtPage.ucSub  = DISPLAY_SUB_PAGE_IDLE;
    
    gDisplay.TgtState.ucMain = DISPLAY_STATE_IDLE;
    gDisplay.TgtState.ucSub  = DISPLAY_SUB_STATE_IDLE;
    
    Disp_Move2Idle();
}

//2019.3.5 add
void Disp_Move2InUse(void)
{
    Disp_Move2DstPage();
    
    Disp_Move2DstState();

	Disp_DisplayInUsePage();

}


//2019.3.5 add
void Disp_Move2Wait(void)
{
    Disp_Move2DstPage();
    
    Disp_Move2DstState();

	Disp_DisplayWaitPage();

}


void Disp_Move2Ready(void)
{
    Disp_Move2DstPage();
    
    Disp_Move2DstState();
    
    Disp_DisplayRunPage();
}

//2019.3.5 add
void Disp_PrepareMove2InUse(void)
{
    gDisplay.tgtPage.ucMain = DISPLAY_PAGE_RUN;
    gDisplay.tgtPage.ucSub  = DISPLAY_SUB_PAGE_IDLE;
    
    gDisplay.TgtState.ucMain = DISPLAY_STATE_IDLE;
    gDisplay.TgtState.ucSub  = DISPLAY_SUB_STATE_IDLE;
	
	Disp_Move2InUse();
}


//2019.3.5 add
void Disp_PrepareMove2Wait(void)
{
    gDisplay.tgtPage.ucMain = DISPLAY_PAGE_WAIT;
    gDisplay.tgtPage.ucSub  = DISPLAY_SUB_PAGE_IDLE;
    
    gDisplay.TgtState.ucMain = DISPLAY_STATE_IDLE;
    gDisplay.TgtState.ucSub  = DISPLAY_SUB_STATE_IDLE;
	
	Disp_Move2Wait();
}

void Disp_PrepareMove2Ready(void)
{
    // transer to idle
    gDisplay.tgtPage.ucMain = DISPLAY_PAGE_RUN;
    gDisplay.tgtPage.ucSub  = DISPLAY_SUB_PAGE_IDLE;
    
    gDisplay.TgtState.ucMain = DISPLAY_STATE_IDLE;
    gDisplay.TgtState.ucSub  = DISPLAY_SUB_STATE_IDLE;
    
    Disp_Move2Ready();
}

void Disp_CirculationInitPage(void)
{
    char *text;
    isInUsePage = 0;
    // display text info
    switch(gDisplay.ucLan)
    {
    default:
    case APP_LAN_ENG:
        text = "Recir. ";
        break;
    case APP_LAN_GER:
        text = "Recir. ";
        break;
    case APP_LAN_CHN:
        text = "循环   ";
        break;
    }
    
    Disp_ShowInfo(text);
    Disp_ShowButtons(TRUE);


}

void Disp_StopQtwTakingWater()
{
    Disp_SndTakingWaterMsg(APP_PACKET_HO_ACTION_STOP,0);

}

void Disp_StopNtwTakingWater()
{
    Disp_SndTakingWaterMsg(APP_PACKET_HO_ACTION_STOP,0);

}

void Disp_Move2Circulation(int bLocal)
{
   Disp_Move2DstPage();

   Disp_Move2DstState();

   Disp_CirculationInitPage();

   // add supervisor time
   if (!bLocal)
   {
       Disp_SndCirMsg(APP_PACKET_HO_ACTION_START);
   }
}


void Disp_PrepareMove2Circulation(int bLocal)
{
    gDisplay.tgtPage.ucMain  = DISPLAY_PAGE_CIRCULATION;
    gDisplay.tgtPage.ucSub   = DISPLAY_SUB_PAGE_IDLE;
    
    gDisplay.TgtState.ucMain = DISPLAY_STATE_CIRCULATION;
    gDisplay.TgtState.ucSub  = DISPLAY_SUB_STATE_IDLE;
    
    Disp_Move2Circulation(bLocal);
}


void Disp_Prepare4Circulation(int bLocal)
{
    Disp_PrepareMove2Circulation(bLocal);
}
void Disp_QtwProductVolumn(void)
{

    int xoff = 0;
    int yoff = 0;
    char buf[16];

	if(gDisplay.bit1ScreenSaver)
	{
		return;
	}

    if (gDisplay.bQtwFlag)
    {
       Disp_Int2float(gDisplay.usQtwWq,buf);
    }
    else
    {
       strcpy(buf,"    ");
    }

    xoff = SHOW_QTWV_X;
    
    yoff = SHOW_QTWV_Y + curFont->sizeY/5*3 - 7;

    curFont->DrawText(xoff,yoff,(u8 *)buf,gDisplay.usForColor,WHITE);

    Disp_SelectFont(&font8);

    if (gDisplay.bQtwFlag)
    {
        curFont->DrawText(xoff + oldfont->sizeX*4 + 1,yoff + oldfont->sizeY - curFont->sizeY + 2,"L",gDisplay.usForColor,WHITE);
    }
    else
    {
        curFont->DrawText(xoff + oldfont->sizeX*4 + 1,yoff + oldfont->sizeY - curFont->sizeY + 2," ",gDisplay.usForColor,WHITE);
    }
    Disp_SelectFont(oldfont);
    
}

void Disp_SpeedUpdatePage()
{  
    Draw_Speed_Progress_Bar();
}

void Disp_QtwSettingInitPage(void)
{
    Disp_QtwProductVolumn();
}

void Disp_QtwSettingUpdatePage(void)
{
     Disp_QtwProductVolumn();
}

void Disp_SpeedSettingUpdatePage()
{
     Disp_SpeedUpdatePage();    
}

void Disp_LiquidLevelSettingUpdatePage()
{
     Disp_LiquidLevelUpdatePage();    
}

void Disp_QtwTakingWaterInitPage(void)
{   
    char *text;
    isInUsePage = 0;
    switch(gDisplay.ucLan)
    {
    default:
    case APP_LAN_ENG:
        text = "Vol Disp";
        break;
    case APP_LAN_GER:
        text = "Vol Aus";
        break;
    case APP_LAN_CHN:
        text = "定量取水";
        break;
    }    

    Disp_ShowInfo(text);
    Disp_ShowButtons(TRUE);

    

}

typedef void (*disp_msg_cb)(void);

void Disp_msg_Handler(Message *Msg)
{
    DISP_MSG *dmsg = (DISP_MSG *)Msg;

    if (dmsg->para)
    {
        ((disp_msg_cb)dmsg->para)();
    }

}


void Disp_Move2QtwTakingWater(int bLocal)
{

   if (!bLocal)
   {
       Disp_SndTakingWaterMsg(APP_PACKET_HO_ACTION_START,(gDisplay.usQtwWq * APP_QTW_UNIT));
   }

   Disp_Move2DstPage();

   // move to qtw taking state
   Disp_Move2DstState();

   Disp_QtwTakingWaterInitPage();

   Disp_SaveQtwVolume();
   Disp_SaveQtwSpeed();
   
}

void Disp_NtwInitPage(void)
{
    char *text;
    isInUsePage = 0;
    switch(gDisplay.ucLan)
    {
    default:
    case APP_LAN_ENG:
        text = "Disp.";
        break;
    case APP_LAN_GER:
        text = "Ausgabe";
        break;
    case APP_LAN_CHN:
        text = "产水";
        break;
    }    
    Disp_ShowInfo(text);
    Disp_ShowButtons(TRUE);
}

void Disp_ntw_msg_cb(void)
{
}

void Disp_ntw_cb(void *para)
{
     Disp_report(Disp_ntw_msg_cb);
}

void Disp_Move2Ntw(int bLocal)
{
   Disp_Move2DstPage();

   Disp_Move2DstState();

   if (!bLocal)
   {
       Disp_SndTakingWaterMsg(APP_PACKET_HO_ACTION_START,INVALID_FM_VALUE);
   }
   
   Disp_NtwInitPage();

}

void Disp_Prepare4Ntw(int bLocal)
{
    gDisplay.tgtPage.ucMain = DISPLAY_PAGE_NORMAL_TAKING_WATER;
    gDisplay.tgtPage.ucSub  = DISPLAY_SUB_PAGE_IDLE;
    
    gDisplay.TgtState.ucMain = DISPLAY_STATE_NORMAL_TAKING_WATER;
    gDisplay.TgtState.ucSub  = DISPLAY_SUB_STATE_IDLE;

    gDisplay.Fm.ulBgnFm      = INVALID_CONFIG_VALUE_LONG;
    gDisplay.Fm.ulCurFm      = INVALID_CONFIG_VALUE_LONG;
    
    Disp_Move2Ntw(bLocal);

}

void Disp_DecInitPage(void)
{

    char *text;
    
    gDisplay.ucOperState = APP_PACKET_HS_STATE_DEC;
    isInUsePage = 0;
    switch(gDisplay.ucLan)
    {
    default:
    case APP_LAN_ENG:
        text = "Pressure Relief";
        break;
    case APP_LAN_GER:
        text = "Druck ablassen";
        break;
    case APP_LAN_CHN:
        text = "泄 压         ";
        break;
    } 

    //Disp_WorkState(0xff,0xff,text);
    Disp_ShowInfo(text);
    Disp_ShowButtons(TRUE);
}

void Disp_Move2Decompression(void)
{
   Disp_Move2DstPage();

   // move to target state
   Disp_Move2DstState();

   Disp_DecInitPage();

}

void Disp_PrepareMove2Dec(void)
{
    // transer to idle
    gDisplay.tgtPage.ucMain = DISPLAY_PAGE_DECPRE;
    gDisplay.tgtPage.ucSub  = DISPLAY_SUB_PAGE_IDLE;
    
    gDisplay.TgtState.ucMain = DISPLAY_STATE_DECOMPRESSION;
    gDisplay.TgtState.ucSub  = DISPLAY_SUB_STATE_IDLE;
    
    Disp_Move2Decompression();
}

void Disp_DrawSelChar(int xoff,int yoff,u8 *string,u16 pos ,u16 charColor,u16 bkColor)
{
    uint8_t tmp;
    
    tmp = string[pos];
    
    string[pos] = 0;
    
    curFont->DrawText(xoff,yoff,string,charColor,bkColor);
    
    xoff += strlen((char *)string)*curFont->sizeX;
    
    curFont->DrawChar(xoff,yoff,tmp,bkColor,charColor);
    
    xoff += curFont->sizeX;
    
    curFont->DrawText(xoff,yoff,&string[pos+1],charColor,bkColor);

    Disp_CleanTail(xoff,yoff,(char *)&string[pos+1],gDisplay.usBackColor4Set);

}

void Disp_DrawSelString(int xoff,int yoff,u8 *string,u16 pos,u16 len ,u16 charColor,u16 bkColor)
{
    uint8_t tmp;
    
    tmp = string[pos];
    
    string[pos] = 0;
    
    curFont->DrawText(xoff,yoff,string,charColor,bkColor);
    
    xoff += strlen((char *)string)*curFont->sizeX;

    string[pos] = tmp;
    tmp = string[pos+len]; 
    string[pos+len] = 0;
    curFont->DrawText(xoff,yoff,&string[pos],bkColor,charColor); // reverse disp
    
    xoff += strlen((char *)&string[pos])*curFont->sizeX;

    string[pos+len] = tmp;
    
    curFont->DrawText(xoff,yoff,&string[pos+len],charColor,bkColor);

}


void Disp_userSetDrawSerialNo(int xoff,int yoff,u16 charColor,u16 bkColor)
{
 
}

void Disp_KeyHandler_idle_idle(int key,int state)
{
}

void Disp_KeyHandler_run_idle(int key,int state)
{
    switch(key)
    {
    case KEY_CODE_HAND_KEY: 
    case KEY_CODE_FOOT_KEY:
        if (KEYSTATE_PRESSED == state)
        {
            Disp_Prepare4Ntw(FALSE);
        }
        break;
    }
}

void Disp_KeyHandler_qtw_Setting(int key,int state)
{
    switch(key)
    {
    case KEY_CODE_FOOT_KEY:
    case KEY_CODE_HAND_KEY:
        Disp_Prepare4Qtw();        
        break;
    }

}

void Disp_KeyHandler_qtw_tw(int key,int state)
{
    // currently empty
    switch(key)
    {
    case KEY_CODE_HAND_KEY:
    case KEY_CODE_FOOT_KEY:
        if (KEYSTATE_PRESSED == state)
        {
            Disp_StopQtwTakingWater();
        }
        break;
    }
}



void Disp_KeyHandler_qtw(int key,int state)
{
    switch(gDisplay.curPage.ucSub)
    {
    case DISPLAY_SUB_PAGE_QUANTITY_TAKING_WATER_SETTING:
        Disp_KeyHandler_qtw_Setting(key,state);
        break;
    case DISPLAY_SUB_PAGE_QUANTITY_TAKING_WATER_TAKING:
        Disp_KeyHandler_qtw_tw(key,state);
        break;
    }
}

void Disp_KeyHandler_ntw_idle(int key,int state)
{
    switch(key)
    {
    case KEY_CODE_HAND_KEY:
    case KEY_CODE_FOOT_KEY:
        if (KEYSTATE_PRESSED == state)
        {
            Disp_StopNtwTakingWater();
        }
        break;
    default:
        break;
    }

}

void Disp_KeyHandler_ntw(int key,int state)
{

    switch(gDisplay.curPage.ucSub)
    {
    case DISPLAY_SUB_PAGE_IDLE:
        Disp_KeyHandler_ntw_idle(key,state);
        break;
    }

}

void Disp_KeyHandler_cir_idle(int key,int state)
{
    switch(key)
    {
    case KEY_CODE_HAND_KEY:
    case KEY_CODE_FOOT_KEY:
        if (KEYSTATE_PRESSED == state)
        {
            Disp_Prepare4Ntw(FALSE);
        }
        break;
    default:
        break;
    }

}

void Disp_KeyHandler_circular(int key,int state)
{
    switch(gDisplay.curPage.ucSub)
    {
    case DISPLAY_SUB_PAGE_IDLE:
        Disp_KeyHandler_cir_idle(key,state);
        break;
    }
}

void Disp_KeyHandler_idle(int key,int state)
{
    switch(gDisplay.curPage.ucSub)
    {
    case DISPLAY_SUB_PAGE_IDLE:
        Disp_KeyHandler_idle_idle(key,state);
        break;
    default:
        break;
    }
}

void Disp_KeyHandler_run(int key,int state)
{
    switch(gDisplay.curPage.ucSub)
    {
    case DISPLAY_SUB_PAGE_IDLE:
        Disp_KeyHandler_run_idle(key,state);
        break;
    default:
        break;
    }
}

void Disp_TouchHandler(TOUCH_EVENT *event)
{
    //printf("Disp_TouchHandler \r\n %d,%d,%d",event->usX,event->usY,event->usEvent);
    
    if (gDisplay.ucDspWelcomeTime > 0)
    {
        return; // for welcome display
    }

    //gDisplay.usIdleLcdTimes = 0; 
    if(event->usEvent)
    {
        //printf("Disp_TouchHandler %d,%d,%d\r\n ",event->usX,event->usY,event->usEvent);
        gDisplay.usIdleLcdTimes = 0;
    }

    if (!LCD_GetBackLightState()
        && (event->usEvent))
    {
        LCD_EnableBackLight(TRUE);
        return;
    }

      if (gDisplay.bit1ScreenSaver
        && (event->usEvent))
    {
        Disp_EnableScreenSaver(FALSE);
        return;
    }  

#if (IWDG_SUPPORT > 0)
    IWDG_Feed();
#endif

    //if (sTsCali.sCalibrating)
    //{
    //    Disp_Calibrating(event);
    //    
    //    return ;
    //}

    if (event->usEvent & 0x1)
    {    
        //printf("B:%d&%d\r\n",event->usX,event->usY);
    
        //tslib_linear_calibrate(event,gTslibLinearCfg.a);

        //printf("E:%d&%d\r\n",event->usX,event->usY);
        BtnTouchEventEntry(event);
    }
    else if (event->usEvent & 0x2)
    {
        uint8_t ucBtnDelta = gDisplay.ucBtnState ^ event->usX;
        
        if ((1 << BUTTON_ID_TW) & ucBtnDelta)
        {
            if ((1 << BUTTON_ID_TW) & event->usX)
            {
            }
            else
            {
                Disp_BtnClicked((void *)BUTTON_ID_TW);
            }
        }
        gDisplay.ucBtnState = event->usX;
    }
    else
    {
        BtnTouchEventEntry(event);
    }
}

void Disp_KeyHandler_Calibrate_idle(int key,int state)
{
    switch(key)
    {
    case KEY_CODE_HAND_KEY: 
    case KEY_CODE_FOOT_KEY:
        if (KEYSTATE_PRESSED == state)
        {
            Disp_Update4State(gDisplay.ucOperState);
        }
        break;
    }
}

void Disp_KeyHandler_wait_qtw(int key,int state)
{
    switch(gDisplay.curPage.ucSub)
    {
    case DISPLAY_SUB_PAGE_IDLE:
        Disp_KeyHandler_qtw_tw(key,state);
        break;
    }
}



void Disp_KeyHandler(int key,int state)
{

    if (gDisplay.ucDspWelcomeTime > 0)
    {
        return; // for welcome display
    }

    printf("key %d:%d\r\n",key,state);

    gDisplay.usIdleLcdTimes = 0;

    if (state == KEYSTATE_UNPRESS)
    {
        gDisplay.KeyMask &=  ~(1 << key) ;
        gDisplay.KeyLong  &= ~(1 << key);
        gDisplay.KeyState[key] =  0 ;
        
    }
    else
    {
        // filter out used keys 
        if (gDisplay.KeyMask & (1 << key))
        {
            return;
        }

        {
            gDisplay.KeyMask |=  (1 << key) ;
        }

        gDisplay.KeyLong      &= ~(1 << key);
        gDisplay.KeyState[key] = 1;
        
    }

    if (!LCD_GetBackLightState()
        && (state == KEYSTATE_PRESSED))
    {
        LCD_EnableBackLight(TRUE);
        return;
    }

    if (gDisplay.bit1ScreenSaver
        && (state == KEYSTATE_PRESSED))
    {
        Disp_EnableScreenSaver(FALSE);
        return;
    }  
    
#if (IWDG_SUPPORT > 0)
    IWDG_Feed();  
#endif

    switch(gDisplay.curPage.ucMain)
    {
    case DISPLAY_PAGE_IDLE:
        Disp_KeyHandler_idle(key,state);
        break;
    case DISPLAY_PAGE_RUN:
        Disp_KeyHandler_run(key,state);
        break;
    case DISPLAY_PAGE_CIRCULATION:
        Disp_KeyHandler_circular(key,state);
        break;
    case DISPLAY_PAGE_NORMAL_TAKING_WATER:
        Disp_KeyHandler_ntw(key,state);
        break;
    case DISPLAY_PAGE_QUANTITY_TAKING_WATER:
        Disp_KeyHandler_qtw(key,state);
        break;
    case DISPLAY_PAGE_WAIT:
        Disp_KeyHandler_wait_qtw(key,state);
        break;
    default:
        break;
    }
}

void Disp_Prepare4Qtw(void)
{
    if (gDisplay.usQtwWq > 0 )
    {
        gDisplay.tgtPage.ucMain = DISPLAY_PAGE_QUANTITY_TAKING_WATER;
        gDisplay.tgtPage.ucSub  = DISPLAY_SUB_PAGE_QUANTITY_TAKING_WATER_TAKING;

        gDisplay.TgtState.ucMain = DISPLAY_STATE_QUANTITY_TAKING_WATER;
        gDisplay.TgtState.ucSub  = DISPLAY_SUB_STATE_IDLE;

        gDisplay.Fm.ulBgnFm      = INVALID_CONFIG_VALUE_LONG;
        gDisplay.Fm.ulCurFm      = INVALID_CONFIG_VALUE_LONG;
        
        Disp_Move2QtwTakingWater(FALSE);

    }
    else
    {
        Disp_Prepare4Circulation(FALSE);
    }
}

void Disp_ReadConfig(void)
{
   gDisplay.cfg = &gCfg;
   gDisplay.cfg->cfg1.devType = CIR_TYPE_NUM; //  DONT CARE
   gDisplay.cfg->cfg1.serial[CONFIG_SERIAL_NAME_LEN] = 0;
}

void Disp_InitConfig(void)
{
    Disp_ReadConfig();
}

void Display_LongKeyHandler(int key,int state)
{
    switch(key)
    {
    case KEY_CODE_HAND_KEY:
        // Display_Prepare4Cali();
        break;
    default:
        break;
    }
}

void DrawScreenSaverMsg()
{
	int xoff;
    int yoff;
    char *buf;
	
	if(APP_DEV_HS_SUB_HYPER == gDisplay.ucDevType)
	{
		buf = "UP";
	}
	else
	{
		buf = "HP";
	}

    Disp_SelectFont(&font48);

	xoff = SHOW_WATER_QUALITY_UNIT_X;
    xoff -= (curFont->sizeX*(strlen(buf)) + 30);
    
    yoff = SHOW_WATER_QUALITY_SHOW_Y + 20;
    
    curFont->DrawText(xoff,yoff,(u8 *)buf, WHITE, gDisplay.usBackColor4ScreenSaver);

    Disp_SelectFont(oldfont);
}

void Disp_EnableScreenSaver(int bEnable)
{
    gDisplay.bit1ScreenSaver = bEnable;

    if (!bEnable)
    {
        Disp_Invalidate();
        return;
    }

    gDisplay.bit1InvalidBtns = TRUE;
    gDisplay.bit1InvalidScreen = TRUE;

    /* Enter into Scree saver */
    Disp_ClearScreen(gDisplay.usBackColor4ScreenSaver);
	DrawScreenSaverMsg();
}


void Disp_SecondTask(void)
{
        
    // late implement, for periodical routine
    if (gDisplay.ucDspWelcomeTime > 0)
    {
        gDisplay.ucDspWelcomeTime--;
        if (0 == gDisplay.ucDspWelcomeTime)
        {
            Disp_Update4State(gDisplay.ucOperState);
        }
    }
    else
    {
        // read sensors periodcally
        gDisplay.usSeconds++;

        if (gDisplay.KeyMask)
        {
            if (gDisplay.KeyMask & (1 << KEY_CODE_HAND_KEY)
                && (!(gDisplay.KeyLong & (1 << KEY_CODE_HAND_KEY))))
            {
                gDisplay.KeyState[KEY_CODE_HAND_KEY]++;
                
                if (gDisplay.KeyState[KEY_CODE_HAND_KEY] > LONGKEY_PRESS_COMM_SECONDS)
                {
                    // prevent next
                    gDisplay.KeyLong |= (1 << KEY_CODE_HAND_KEY);
        
                    // do someting
                    Display_LongKeyHandler(KEY_CODE_HAND_KEY,KEYSTATE_PRESSED);
                }
            }

        }

        if (DISPLAY_STATE_IDLE == gDisplay.CurState.ucMain)
        {
            gDisplay.usIdleTimes++;

            if (DISPLAY_PAGE_IDLE == gDisplay.curPage.ucMain
                && DISPLAY_SUB_PAGE_IDLE == gDisplay.curPage.ucSub)
            {
                Disp_UpdateIdlePage();
            }
	     /*
            gDisplay.usIdleLcdTimes++;

            if (gDisplay.usIdleLcdTimes >= DISP_LCD_DORMANT_TIME)
            {
                //LCD_EnableBackLight(FALSE);
                if (!gDisplay.bit1ScreenSaver)
                {
                    Disp_EnableScreenSaver(TRUE);
                }

                gDisplay.usIdleLcdTimes = 0;
            }
         */
        }
		
		if((APP_PACKET_HS_STATE_QTW != gDisplay.ucOperState)
			&& (APP_PACKET_HS_STATE_DEC != gDisplay.ucOperState)
			&& (APP_PACKET_HS_STATE_CIR != gDisplay.ucOperState))
		{
			gDisplay.usIdleLcdTimes++;
            if (gDisplay.usIdleLcdTimes >= DISP_LCD_DORMANT_TIME)
            {
                //LCD_EnableBackLight(FALSE);
                if (!gDisplay.bit1ScreenSaver)
                {
                    Disp_EnableScreenSaver(TRUE);
                }
                gDisplay.usIdleLcdTimes = 0;
            }
            //printf("usIdleLcdTimes %d\r\n",gDisplay.usIdleLcdTimes);
		}

        if ((gDisplay.usSeconds % 60) == 0)
        {
            // begin modify for V2: remark precompiler: SHOW_TIME 
        }
    }
    if(isInUsePage)
    {
        if(isUpdTimer)
        {
            isInUseTimer = gDisplay.usSeconds;
            isUpdTimer = 0;
        }
        
        if(gDisplay.usSeconds - isInUseTimer > 3)
        {
            Disp_DisplayRunPage();
            isUpdTimer = 1;
        }
    }
}

void Disp_DisplayWelcomePage(void)
{

    Disp_ClearScreen(gDisplay.usBackColor);

    // display text info
    curFont->DrawText(10,40,"Loading...",gDisplay.usForColor,gDisplay.usBackColor);
    
    Disp_ShowTime();
}


void Disp_Invalidate(void)
{
    //uint16_t color[] = {WHITE,YELLOW,RED,YELLOW};
#if (IWDG_SUPPORT > 0)
     IWDG_Feed();  
#endif
    
    switch(gDisplay.curPage.ucMain)
    {
    case DISPLAY_PAGE_IDLE:
        switch(gDisplay.curPage.ucSub)
        {
        case DISPLAY_SUB_PAGE_IDLE:
            Disp_DisplayIdlePage();
            break;
        }
        break;
    case DISPLAY_PAGE_RUN:
       	Disp_DisplayRunPage();
        break;
    case DISPLAY_PAGE_CIRCULATION:
        Disp_CirculationInitPage();
        break;
    case DISPLAY_PAGE_NORMAL_TAKING_WATER:
        Disp_NtwInitPage();
        break;
    case DISPLAY_PAGE_QUANTITY_TAKING_WATER:
        Disp_QtwTakingWaterInitPage();
        break;
    }
    
}

void Disp_DisplayHandleOpsTimeout(uint8_t ucOpType)
{
   
   switch(ucOpType)
   {
   case APP_PACKET_HO_CIR:
       {
           gDisplay.ucOperRslt = APP_PACKET_HO_ERROR_CODE_TIMEOUT;

           Disp_PrepareMove2Ready();
       }
       break;
   case APP_PACKET_HO_QTW:
       {
          gDisplay.ucOperRslt = APP_PACKET_HO_ERROR_CODE_TIMEOUT;

          //Disp_PrepareMove2Ready();
          Disp_PrepareMove2Wait();
		  VOS_LOG(VOS_LOG_DEBUG, "xxxxxxxx time out xxxxx");
       }
       break;
   default:
       break;
   }
}

/* act according to peer state */
void Disp_PeerStateIdle(void)
{   
    if (DISPLAY_PAGE_IDLE != gDisplay.curPage.ucMain)
    {
        Disp_PrepareMove2Idle();
    }
}

void Disp_PeerStateDec(void)
{   
    if (DISPLAY_PAGE_DECPRE != gDisplay.curPage.ucMain)
    {
        Disp_PrepareMove2Dec();
    }
}

//2019.3.5
void Disp_PeerStateWait(void)
{
    if (DISPLAY_PAGE_RUN != gDisplay.curPage.ucMain)
    {
        Disp_PrepareMove2Wait();
    }

}

void Disp_PeerStateRun(void)
{
    if (DISPLAY_PAGE_RUN != gDisplay.curPage.ucMain)
    {
        Disp_PrepareMove2Ready();
    }
}

void Disp_PeerStateQtw(void)
{
    if (DISPLAY_PAGE_NORMAL_TAKING_WATER != gDisplay.curPage.ucMain
        && DISPLAY_PAGE_QUANTITY_TAKING_WATER != gDisplay.curPage.ucMain)
    {
        Disp_Prepare4Ntw(TRUE);
    }
}

void Disp_PeerStateCir(void)
{
    if (DISPLAY_PAGE_CIRCULATION != gDisplay.curPage.ucMain)
    {
        Disp_Prepare4Circulation(TRUE);
    }
}

void Disp_Update4State(uint8_t ucState)
{
	isQtwing = 0;
    switch(ucState)
    {
    case APP_PACKET_HS_STATE_IDLE:
        Disp_PeerStateIdle();
        gDisplay.ucTwType = APP_DEV_HS_SUB_NUM;
        break;
    case APP_PACKET_HS_STATE_RUN:
        Disp_PeerStateRun();
        gDisplay.ucTwType = APP_DEV_HS_SUB_NUM;
		break;
		
	case APP_PACKET_HS_STATE_WAIT:  //2019.3.5 add
		isQtwing = 1;
		Disp_PeerStateWait();
        gDisplay.ucTwType = APP_DEV_HS_SUB_NUM;
		break;
		 	
    case APP_PACKET_HS_STATE_QTW:
        Disp_PeerStateQtw();
        break;
    case APP_PACKET_HS_STATE_CIR:
        Disp_PeerStateCir();
        gDisplay.ucTwType = APP_DEV_HS_SUB_NUM;
        break;
    case APP_PACKET_HS_STATE_DEC:
        Disp_PeerStateDec();
        gDisplay.ucTwType = APP_DEV_HS_SUB_NUM;
        break;
    }
}

void Disp_ClientRptWQUpdate(uint8_t ucId)
{
    switch(gDisplay.curPage.ucMain)
    {
    case DISPLAY_PAGE_IDLE:
    case DISPLAY_PAGE_RUN:
    case DISPLAY_PAGE_CIRCULATION:
    case DISPLAY_PAGE_NORMAL_TAKING_WATER:
    case DISPLAY_PAGE_QUANTITY_TAKING_WATER:
        {
           if (APP_EXE_I5_NO == ucId )
           {
               Disp_UpdateWaterQuality(gDisplay.I5.fWaterQ);    

               Disp_UpdateRti4Temp(gDisplay.I5.usTemp);    
           }
          
           if (APP_EXE_I4_NO == ucId )
           {
               Disp_UpdateWaterQuality(gDisplay.I4.fWaterQ);    

               Disp_UpdateRti4Temp(gDisplay.I4.usTemp);    
           
           }  
        }
        break;
    }
    
}

void Disp_UpdateEco(APP_PACKET_RPT_ECO_STRU *pEco)
{
    switch (pEco->ucId)
    {
    case APP_EXE_I2_NO:
		if ( APP_DEV_HS_SUB_REGULAR == gDisplay.ucDevType)
		{
			isI2 = 1;
			if ((APP_PACKET_HS_STATE_QTW == gDisplay.ucOperState
				&& gDisplay.ucDevType == gDisplay.ucTwType)
				||(APP_PACKET_HS_STATE_CIR == gDisplay.ucOperState))
			{
				gDisplay.I4.fWaterQ = pEco->ev.fWaterQ;
				gDisplay.I4.usTemp	= pEco->ev.usTemp;
				gDisplay.fWaterQuality = pEco->ev.fWaterQ;
				gDisplay.iTemperature = pEco->ev.usTemp;
				
				Disp_ClientRptWQUpdate(APP_EXE_I4_NO);
			}
		}

        break;
    case APP_EXE_I4_NO:
        
        if ( APP_DEV_HS_SUB_REGULAR == gDisplay.ucDevType)
        {
        	isI2 = 0;
            if ((APP_PACKET_HS_STATE_QTW == gDisplay.ucOperState
                && gDisplay.ucDevType == gDisplay.ucTwType)
                ||(APP_PACKET_HS_STATE_CIR == gDisplay.ucOperState))
            {
                gDisplay.I4.fWaterQ = pEco->ev.fWaterQ;
                gDisplay.I4.usTemp  = pEco->ev.usTemp;
                gDisplay.fWaterQuality = pEco->ev.fWaterQ;
                gDisplay.iTemperature = pEco->ev.usTemp;
                
                Disp_ClientRptWQUpdate(pEco->ucId);
            }
        }
        break;
    case APP_EXE_I5_NO:
        if ( APP_DEV_HS_SUB_HYPER == gDisplay.ucDevType)
        {
        	isI2 = 0;   
            if ((APP_PACKET_HS_STATE_QTW == gDisplay.ucOperState
                && gDisplay.ucDevType == gDisplay.ucTwType)
                ||(APP_PACKET_HS_STATE_CIR == gDisplay.ucOperState))
            {
                gDisplay.I5.fWaterQ = pEco->ev.fWaterQ;
                gDisplay.I5.usTemp  = pEco->ev.usTemp;
                gDisplay.fWaterQuality = pEco->ev.fWaterQ;
                gDisplay.iTemperature = pEco->ev.usTemp;
                
                Disp_ClientRptWQUpdate(pEco->ucId);
            }
            
            //VOS_LOG(VOS_LOG_DEBUG,"APP_EXE_I5_NO %d&%f",(int)pEco->ev.fWaterQ*10,pEco->ev.fWaterQ);
        }
        break;
    }
}

void Disp_ClientRpt4ExeBoard(APP_PACKET_CLIENT_RPT_IND_STRU *pmg)
{
    //printf("exe: %d \r\n",pmg->ucRptType);

    switch(pmg->ucRptType)
    {
    case APP_PACKET_RPT_ECO:
        {
            int iPackets = (pmg->hdr.ucLen - 1) / sizeof (APP_PACKET_RPT_ECO_STRU);
            APP_PACKET_RPT_ECO_STRU *pEco = (APP_PACKET_RPT_ECO_STRU *)pmg->aucData;
            int iLoop;

            for (iLoop = 0; iLoop < iPackets; iLoop++,pEco++ )
            {
                Disp_UpdateEco(pEco);
            }
        }
        break;
    default:
        break;
    }
}

int Disp_CalcVolume(void)
{
    return ((gDisplay.Fm.ulCurFm - gDisplay.Fm.ulBgnFm) * 1000) / gDisplay.usPulseNum;
}


void Disp_ClientRptFmUpdate(uint8_t ucId)
{
    switch(gDisplay.curPage.ucMain)
    {
    case DISPLAY_PAGE_NORMAL_TAKING_WATER:
    case DISPLAY_PAGE_QUANTITY_TAKING_WATER:
        {
           if (APP_FM_FM1_NO == ucId )
           {
               Disp_UpdateTitle4Status(Disp_CalcVolume());    
           }

        }
        break;
    }
}


void Disp_ClientRpt4FmBoard(APP_PACKET_CLIENT_RPT_IND_STRU *pmg)
{
    printf("fm: %d \r\n",pmg->ucRptType);

    switch(pmg->ucRptType)
    {
    case APP_PACKET_RPT_FM:
        {
            int iPackets = (pmg->hdr.ucLen - 1) / sizeof (APP_PACKET_RPT_FM_STRU);
            APP_PACKET_RPT_FM_STRU *pFm = (APP_PACKET_RPT_FM_STRU *)pmg->aucData;
            int iLoop;

            for (iLoop = 0; iLoop < iPackets; iLoop++,pFm++ )
            {
                switch (pFm->ucId)
                {
                case APP_FM_FM1_NO:
                    if (gDisplay.Fm.ulBgnFm == INVALID_CONFIG_VALUE_LONG)
                    {
                        gDisplay.Fm.ulBgnFm  = pFm->ulValue;
                    }

                    if (gDisplay.Fm.ulCurFm != pFm->ulValue)
                    {
                        gDisplay.Fm.ulCurFm = pFm->ulValue;
                        Disp_ClientRptFmUpdate(pFm->ucId);
                    }
                    break;
                default:
                    break;
                }
            }
        }
        break;
    default:
        break;
    }
}


void Disp_ClientReportEntry(APP_PACKET_CLIENT_RPT_IND_STRU *pClientRptMsg)
{
    switch(pClientRptMsg->hdr.ucDevType)
    {
    case APP_DEV_TYPE_EXE_BOARD:
         //Disp_ClientRpt4ExeBoard(pClientRptMsg); //Can通讯时直接接收执行板的数据
         break;
    case APP_DEV_TYPE_FLOW_METER:
         //Disp_ClientRpt4FmBoard(pClientRptMsg);
         break;
    default:
        break;
    }
}

uint8_t Disp_GetTwFlag(uint8_t ucTwMap)
{
    return  !!(ucTwMap & ( 1 << (CanAddress - APP_HAND_SET_BEGIN_ADDRESS)));

}

void Disp_DisplayTWNotify(uint8_t ucTwFlag)
{
    if(ucTwFlag)
   {
        if (!GetRelayLogicStatus(RELAY_VALVE_1))   
        {
            RelayLogicCtrl(RELAY_VALVE_1,TRUE); 
        }
    }
    else
    {
        if (GetRelayLogicStatus(RELAY_VALVE_1))   
        {
            RelayLogicCtrl(RELAY_VALVE_1,FALSE); 
        }
    }
}

void Disp_DisplayStaNotify(uint8_t ucState)
{
    gDisplay.ucOperState = ucState;
    
    Disp_Update4State(gDisplay.ucOperState);

}


void Disp_DisplayStateNotify(uint8_t ucState,uint8_t ucAddData, uint8_t ucExtraData,uint8_t ucAlarmState)
{
    uint8_t ucOldState = gDisplay.ucOperState;

	//ex   Synchronous alarm status
	if (gDisplay.ucAlarmState != ucAlarmState) 
    {
    	gDisplay.ucAlarmState = ucAlarmState;        
        Disp_ProcessAlarmInd(TRUE);
    }
	//end
    if(APP_PACKET_HS_STATE_QTW == ucState)
    {
        if (Disp_GetTwFlag(ucAddData)) 
        {
            Disp_DisplayTWNotify(TRUE);
            
            Disp_DisplayStaNotify(ucState);
        }
        else
        {   
            if (Disp_GetTwFlag(ucExtraData))
            {
    	        Disp_DisplayStaNotify(APP_PACKET_HS_STATE_WAIT);
            }
            else
            {
                Disp_DisplayStaNotify(APP_PACKET_HS_STATE_RUN);
            }
            
            Disp_DisplayTWNotify(FALSE);
        }           
    }
    else if(APP_PACKET_HS_STATE_CIR == ucState)
    {
        switch(ucAddData) 
        {
        case CIR_TYPE_HP:
            if(APP_DEV_HS_SUB_REGULAR == gDisplay.ucDevType)
             {
                Disp_DisplayStaNotify(ucState);
             }
            else
             {
                Disp_DisplayStaNotify(APP_PACKET_HS_STATE_RUN);
             }
            break;
        case CIR_TYPE_UP:
            if(APP_DEV_HS_SUB_HYPER == gDisplay.ucDevType)
             {
                Disp_DisplayStaNotify(ucState);
             }
            else
             {
                Disp_DisplayStaNotify(APP_PACKET_HS_STATE_RUN);
             }
            break;
        }
    }
    else
    {
        Disp_DisplayStaNotify(ucState);
    }

    if (ucOldState == gDisplay.ucOperState
        && APP_PACKET_HS_STATE_IDLE == gDisplay.ucOperState)
    {
        Disp_DisplayIdlePage();
    }

}

void Disp_DisplayHeartBeatNotify(APP_PACKET_HO_STATE_STRU *pHoState)
{
     Disp_DisplayStateNotify(pHoState->ucState,pHoState->ucAddData,pHoState->ucResult,pHoState->ucAlarmState);
}

void Disp_OpsAdrSet(uint8_t ucTrxIndex,APP_PACKET_HO_STRU *pHoMsg)
{
    /* first compare SN */
	if (memcmp(pHoMsg->aucData,gDisplay.cfg->cfg1.serial,CONFIG_SERIAL_NAME_LEN))
	{
	    return ;
	}

    {
		uint16_t usAdr = (pHoMsg->aucData[CONFIG_SERIAL_NAME_LEN] << 8) | (pHoMsg->aucData[CONFIG_SERIAL_NAME_LEN + 1]);

		if (usAdr < APP_HAND_SET_BEGIN_ADDRESS
			|| usAdr > APP_HAND_SET_END_ADDRESS)
		{
		   return ;
		}

		CanCmdSetAdr(usAdr);


        CanCcbResetRegisterFlag(Trx2CanCcbIndex(ucTrxIndex));

		/* give response */
		{
    		uint8_t buf[16];
			
    		APP_PACKET_HO_STRU *pRsp = (APP_PACKET_HO_STRU *)buf;
    		
    		pRsp->hdr.ucLen 	= 1 + 0;
    		pRsp->hdr.ucTransId = 0;
    		pRsp->hdr.ucDevType = APP_DEV_TYPE_HAND_SET;
    		pRsp->hdr.ucMsgType = APP_PACKET_HAND_OPERATION | 0X80;
    		pRsp->ucOpsType 	= APP_PACKET_HO_ADR_SET ;
    		
    		(void)CanSndSappCmd2(Trx2CanCcbIndex(ucTrxIndex),APP_DEV_TYPE_MAIN_CTRL,CanAddress,SAPP_CMD_DATA,buf,APP_POROTOL_PACKET_HO_COMMON_LENGTH);
	    }
    }
}

void Disp_OpsAdrQry(uint8_t ucTrxIndex,APP_PACKET_HO_STRU *pHoMsg)
{
	/* give response */
	{
		uint8_t buf[32];
		int iIdx = 0;
		
		APP_PACKET_HO_STRU *pRsp = (APP_PACKET_HO_STRU *)buf;
		
		pRsp->hdr.ucLen 	= 1;
		pRsp->hdr.ucTransId = 0;
		pRsp->hdr.ucDevType = APP_DEV_TYPE_HAND_SET;  // message src obj type
		pRsp->hdr.ucMsgType = APP_PACKET_HAND_OPERATION  | 0X80;
		pRsp->ucOpsType 	= APP_PACKET_HO_ADR_QRY;

		pRsp->aucData[iIdx++] = gDisplay.ucDevType;

		memcpy(&pRsp->aucData[iIdx],gDisplay.cfg->cfg1.serial,CONFIG_SERIAL_NAME_LEN);
		iIdx += CONFIG_SERIAL_NAME_LEN;

		pRsp->aucData[iIdx++] = (CanAddress >> 8) & 0XFF;
		pRsp->aucData[iIdx++] = (CanAddress >> 0) & 0XFF;

		pRsp->hdr.ucLen 	+= iIdx;

		CanHashAddr = CanAddress;

		if (INVALID_CAN_ADDRESS(CanHashAddr))
		{
			// calc hash address
			CanHashAddr = CanCmdHashAdr();
		}
		
		(void)CanSndSappCmd2(Trx2CanCcbIndex(ucTrxIndex),APP_DEV_TYPE_MAIN_CTRL,CanHashAddr,SAPP_CMD_DATA,buf,APP_PROTOL_HEADER_LEN + pRsp->hdr.ucLen);
    }
	
}

void Disp_ProcessAlarmInd(uint8_t ucInvalidate)
{
    if (gDisplay.ucAlarmState & APP_PACKET_HO_ALARM_TYPE_ALM)
    {
        gDisplay.usBackColor = RED;
    }
    else if (gDisplay.ucAlarmState & APP_PACKET_HO_ALARM_TYPE_NOT)
    {
        gDisplay.usBackColor = YELLOW;
    }
    else
    {
        gDisplay.usBackColor = WHITE;
    }

    gDisplay.bit1InvalidScreen = ucInvalidate;    
   
    if (ucInvalidate) 
    {
        Disp_Invalidate();
    }

}


void Disp_DisplayHandleIndConf(uint8_t ucTrxIndex,APP_PACKET_ONLINE_NOTI_CONF_STRU *pIndConf)
{
	APP_PACKET_ONLINE_NOTI_CONF_HANDLER_STRU *pInfo = (APP_PACKET_ONLINE_NOTI_CONF_HANDLER_STRU *)pIndConf->aucInfo;
   // gDisplay.ucLan     = APP_LAN_ENG;
	gDisplay.ucLan     = pInfo->ucLan;
    gDisplay.ucDevType = pInfo->ucMode;

    gDisplay.ucLiquidLevel = pInfo->ucLiquidLevel;
    gDisplay.ucQtwSpeed    = pInfo->ucQtwSpeed;
    gDisplay.ucHaveTOC     = pInfo->ucHaveTOC;

    printf("Disp_DisplayHandleIndConf gDisplay.ucHaveTOC %d \r\n",gDisplay.ucHaveTOC);

    gDisplay.ucOperState   = pInfo->ucState;

    gDisplay.ucTrxMap     |= (1 << ucTrxIndex);
    
    if (gDisplay.ucAlarmState != pInfo->ucAlarmState)
    {
        gDisplay.ucAlarmState = pInfo->ucAlarmState;
        
        Disp_ProcessAlarmInd(FALSE);
    }

    switch(ucTrxIndex)
    {
    case APP_TRX_CAN:
        zbActivate(FALSE);
        break;
    }
    
    Disp_DisplayStateNotify(pInfo->ucState,pInfo->ucAddData,0, pInfo->ucAlarmState);
    
}

void Disp_zbResetInd(void)
{
    gDisplay.ucTrxMap &= ~(1 << APP_TRX_ZIGBEE);
}


void Disp_BtnTwClick(void)
{
    switch(gDisplay.ucOperState)
    {
    case APP_PACKET_HS_STATE_IDLE:
        Disp_SndDecPressureMsg(APP_PACKET_HO_ACTION_START,APP_PACKET_HO_SYS_TEST_TYPE_DEPRESSURE);
        break;
    case APP_PACKET_HS_STATE_RUN:
    case APP_PACKET_HS_STATE_CIR:
        if (gDisplay.bQtwFlag)
        {
            Disp_Prepare4Qtw();
        }
        else
        {
            Disp_Move2Ntw(FALSE);
        }
        break;
    case APP_PACKET_HS_STATE_QTW:
    case APP_PACKET_HS_STATE_WAIT:
        Disp_SndTakingWaterMsg(APP_PACKET_HO_ACTION_STOP,0);
        break;
    case APP_PACKET_HS_STATE_DEC:
        Disp_SndDecPressureMsg(APP_PACKET_HO_ACTION_STOP,APP_PACKET_HO_SYS_TEST_TYPE_DEPRESSURE);
        break;
    }
}

void Disp_DisplayHandleOpsEntry(uint8_t ucTrxIndex,APP_PACKET_HO_STRU *pHoMsg,uint8_t ucDedicated)
{
   gDisplay.ucTrxIndex = ucTrxIndex;
   
   VOS_LOG(VOS_LOG_DEBUG, "Disp_DisplayHandleOpsEntry %d",pHoMsg->ucOpsType);
   switch(pHoMsg->ucOpsType)
   {
   case APP_PACKET_HO_CIR:
       {
           APP_PACKET_HO_CIR_RSP_STRU *pCirRsp = (APP_PACKET_HO_CIR_RSP_STRU *)pHoMsg->aucData;
           if(pCirRsp->ucResult)
           {
               Disp_PrepareMove2Ready();
           }
           gDisplay.ucOperRslt = pCirRsp->ucResult;
       }
       break;
   case APP_PACKET_HO_QTW:
       {
           APP_PACKET_HO_QTW_RSP_STRU *pQtwRsp = (APP_PACKET_HO_QTW_RSP_STRU *)pHoMsg->aucData; 

           VOS_LOG(VOS_LOG_DEBUG, "APP_PACKET_HO_QTW %d&%d&%d",ucDedicated,pQtwRsp->ucType,gDisplay.ucDevType);

           if (ucDedicated)
           {
           	   //2019.3.5 add
           	   if(APP_PACKET_HO_ERROR_CODE_UNSUPPORT == pQtwRsp->ucResult)
           	   {
           	       Disp_PrepareMove2InUse();
           	   } //end
           	   
               else if(pQtwRsp->ucResult)
               {
                   Disp_PrepareMove2Ready();
               }
               else
               {
                   if (APP_PACKET_HO_ACTION_START == pQtwRsp->ucAction)
                   {
                       if (ucDedicated)
                       {
                          gDisplay.bQtwFlag = FALSE;               
                          RelayLogicCtrl(RELAY_VALVE_1,TRUE);  
                       }
        
                       if (0 != pQtwRsp->usPulseNum
                           && 0XFFFF != pQtwRsp->usPulseNum)
                       {
                            gDisplay.usPulseNum =  pQtwRsp->usPulseNum;
                       }
                       
                       if (0 != pQtwRsp->ulVolumn
                         && INVALID_FM_VALUE != pQtwRsp->ulVolumn)
                       {
                            if (pQtwRsp->ucType == gDisplay.ucDevType)
                            {
                                VOS_LOG(VOS_LOG_DEBUG, "APP_PACKET_HO_QTW %d",pQtwRsp->ucType);
                                
                                if((MAX_TW_VOLUME < pQtwRsp->ulVolumn))
                                {
                                    LCD_ClearRect(SHOW_QTWV_X,SHOW_QTWV_Y,MAKE_RIGHT_CORD(SHOW_QTWV_X,SHOW_QTWV_W),MAKE_BOTTOM_CORD(SHOW_QTWV_Y,SHOW_QTWV_H),WHITE);
                                }
                            
                                gDisplay.usQtwWq = pQtwRsp->ulVolumn / APP_QTW_UNIT;
                                
                                Disp_QtwProductVolumn();
                            }
                       }
                       
                       if (0 == pQtwRsp->ucUnit 
                          || 1 == pQtwRsp->ucUnit )
                       {
                           if (gDisplay.ucUnit != pQtwRsp->ucUnit)
                           {
                               gDisplay.ucUnit = pQtwRsp->ucUnit;
                               LCD_ClearRect(2,SHOW_WATER_QUALITY_Y + 5,MAKE_RIGHT_CORD(2,SHOW_WATER_QUALITY_UNIT_X - 2),MAKE_BOTTOM_CORD(SHOW_WATER_QUALITY_Y,SHOW_WATER_QUALITY_H) - 5,gDisplay.usBackColor);
                           }
                       }

                       if (DISPLAY_PAGE_NORMAL_TAKING_WATER != gDisplay.curPage.ucMain)
                       {
                          Disp_DisplayStaNotify(APP_PACKET_HS_STATE_QTW);
                          //Disp_Update4State(APP_PACKET_HS_STATE_QTW);
                       }   
    
                   }
                   else
                   {
                       if (ucDedicated)
                       {
                          gDisplay.bQtwFlag = FALSE;               
                          RelayLogicCtrl(RELAY_VALVE_1,FALSE);  
                       }
                       
                       LCD_ClearRect(SHOW_QTWV_X,SHOW_QTWV_Y,MAKE_RIGHT_CORD(SHOW_QTWV_X,SHOW_QTWV_W),MAKE_BOTTOM_CORD(SHOW_QTWV_Y,SHOW_QTWV_H),WHITE);
                   }
               }
               gDisplay.ucOperRslt = pQtwRsp->ucResult;
               gDisplay.ucTwType   = pQtwRsp->ucType;
           }
       }
       break;
   case APP_PACKET_HO_SPEED:
       {
           APP_PACKET_HO_SPEED_RSP_STRU *pSpdRsp = (APP_PACKET_HO_SPEED_RSP_STRU *)pHoMsg->aucData; 

           if(0 == pSpdRsp->ucResult)
           {
              if(gDisplay.ucDevType == pSpdRsp->ucType)
              {
                   gDisplay.ucQtwSpeed =  pSpdRsp->ucSpeed;
    
                   /* update ui */
                   Disp_SpeedSettingUpdatePage();
              }
           }
       }
       break;
   case APP_PACKET_HO_STA:
       {
           APP_PACKET_HO_STATE_STRU *pStaMsg = (APP_PACKET_HO_STATE_STRU *)pHoMsg->aucData;

           // 2018/04/09 Modify: 只有本地取水才更新取水状态
           //if ((GetRelayLogicStatus(RELAY_VALVE_1)
                 //&& APP_PACKET_HS_STATE_QTW == pStaMsg->ucState)
               //|| APP_PACKET_HS_STATE_QTW != pStaMsg->ucState)
           if (Disp_GetTrxIndex() == ucTrxIndex)
           {
               Disp_DisplayStateNotify(pStaMsg->ucState,pStaMsg->ucAddData, pStaMsg->ucResult,pStaMsg->ucAlarmState);
           }
       }
       break;
   case APP_PACKET_HO_ADR_RST:
   	   {
           CanCmdSetAdr(APP_PROTOL_CANID_INVALID);	

		   if (APP_TRX_CAN == ucTrxIndex)
           {
               HAL_SYSTEM_RESET();
           }
   	   }
       break;
   case APP_PACKET_HO_ADR_SET:
	   {
	       Disp_OpsAdrSet(ucTrxIndex,pHoMsg); 	
	   }
	   break;
   case APP_PACKET_HO_ADR_QRY:
	   {
	 	   Disp_OpsAdrQry(ucTrxIndex,pHoMsg);
	   }
   	   break;
   case APP_PACKET_HO_QL_UPDATE:
       {
            APP_PACKET_HO_QL_UPD_STRU *pLevelMsg = (APP_PACKET_HO_QL_UPD_STRU *)pHoMsg->aucData;

            if(APP_PACKET_HO_QL_TYPE_LEVEL & pLevelMsg->ucMask)
            {
               if((gDisplay.ucLiquidLevel != pLevelMsg->ucLevel) 
			   	&&((100 <= gDisplay.ucLiquidLevel ) && (100 > pLevelMsg->ucLevel))
			   	&& (!gDisplay.bit1ScreenSaver))
               { 
                   LCD_ClearRect(150,3,235,30,gDisplay.usBackColor);
               }
               
               gDisplay.ucLiquidLevel = pLevelMsg->ucLevel;
               /* update liquid level */
               Disp_LiquidLevelSettingUpdatePage();
            }

            if(APP_PACKET_HO_QL_TYPE_PPB & pLevelMsg->ucMask)
            {
                VOS_LOG(VOS_LOG_DEBUG, "APP_PACKET_HO_QL_TYPE_PPB %d",pLevelMsg->fWaterQppb);
                    
                gDisplay.fWaterPPB = pLevelMsg->fWaterQppb;
                
                Disp_UpdateRti4State(gDisplay.fWaterPPB);
            }
       }
       break;
   case APP_PACKET_HO_ALARM_STATE_NOT:
        {
            APP_PACKET_HO_ALARM_STATE_NOT_STRU *pAbnormal = (APP_PACKET_HO_ALARM_STATE_NOT_STRU *)pHoMsg->aucData;

            if (gDisplay.ucAlarmState != pAbnormal->ucMask)
            {
                gDisplay.ucAlarmState = pAbnormal->ucMask;
                
                Disp_ProcessAlarmInd(TRUE);
            }
        }
        break;
   case APP_PACKET_HO_SYSTEM_TEST:
        {
            APP_PACKET_HO_SYSTEMTEST_REQ_STRU *pSysTest = (APP_PACKET_HO_SYSTEMTEST_REQ_STRU *)pHoMsg->aucData; 

            if((APP_PACKET_HO_SYS_TEST_TYPE_DEPRESSURE == pSysTest->ucType)
                && (APP_PACKET_HO_ACTION_START == pSysTest->ucAction))
            {
                Disp_DisplayStaNotify(APP_PACKET_HS_STATE_DEC);
            }
            else
            {
                Disp_DisplayStaNotify(APP_PACKET_HS_STATE_IDLE);
            }
            
            Disp_SndSystemTestRspMsg(ucTrxIndex,pSysTest);
        }
        break;
   case APP_PACKET_HO_WQ_NOTIFY:
        {
            int iPackets = (pHoMsg->hdr.ucLen - 1) / sizeof (APP_PACKET_RPT_ECO_STRU);
            APP_PACKET_RPT_ECO_STRU *pEco = (APP_PACKET_RPT_ECO_STRU *)pHoMsg->aucData;
            int iLoop;
            VOS_LOG(VOS_LOG_DEBUG, "APP_PACKET_HO_WQ_NOTIFY %d",iPackets);

            for (iLoop = 0; iLoop < iPackets && iLoop < APP_EXE_ECO_NUM; iLoop++,pEco++ )
            {
                Disp_UpdateEco(pEco);
            }
        }
        break;
   default:
        break;
   }
 
   VOS_LOG(VOS_LOG_WARNING,"HO %d&%d\r\n",pHoMsg->ucOpsType,gDisplay.ucOperState);
}



void Disp_CanItfNotify(uint8_t ucTrxIndex,int code)
{
    switch(code)
    {
    case DISP_CANITF_CODE_LOST_HB:
        {
            Disp_PrepareMove2Idle();
            
            zb_PrepareReset();     
        }
        break;
    default:
        break;
    }
}


void Disp_BtnCirClick(void)
{
    switch(gDisplay.ucOperState)
    {
    case APP_PACKET_HS_STATE_RUN:
        Disp_PrepareMove2Circulation(FALSE);        
        break;
    case APP_PACKET_HS_STATE_CIR:
        Disp_SndCirMsg(APP_PACKET_HO_ACTION_STOP);
        break;
    default:
        break;
    }
}

void Disp_BtnDecClick(void)
{
    //BtnShow(gpBtnTWDec,TRUE);
	if(0 == gDisplay.usQtwWq)
	{
        return ;
	}
    
    if (!gDisplay.bQtwFlag)
    {
        Disp_QtwSettingUpdatePage(); 
        gDisplay.bQtwFlag = TRUE;
    }
    else
    {
    
        gDisplay.usQtwWq--;

        if (0 == gDisplay.usQtwWq)
        {
            gDisplay.bQtwFlag = FALSE;  
        }
        
        Disp_QtwSettingUpdatePage(); 
    
    }
    
}

void Disp_BtnIncClick(void)
{
    if (!gDisplay.bQtwFlag)
    {
        Disp_QtwSettingUpdatePage(); 
        gDisplay.bQtwFlag = TRUE;
    }
    else
    {
        if (gDisplay.usQtwWq < (DISP_MAX_WATER_VOLUME-1))
        {
            gDisplay.usQtwWq++;
        }
        
        Disp_QtwSettingUpdatePage(); 
    }
}

void Disp_BtnSpeedIncClick(void)
{
    Disp_SndTwSpeedMsg(APP_PACKET_HO_ACTION_START); 
}

void Disp_BtnSpeedDecClick(void)
{    
    Disp_SndTwSpeedMsg(APP_PACKET_HO_ACTION_STOP); 
}


void Disp_BtnClicked(void *para)
{
    int iBtnId = (int)para;

    VOS_LOG(VOS_LOG_DEBUG,"btn %d\r\n",iBtnId);

    switch(iBtnId)
    {
    case BUTTON_ID_TW:
        Disp_BtnTwClick();
        break;
    case BUTTON_ID_CIR:
        Disp_BtnCirClick();
        break;    
    case BUTTON_ID_TWInc:
        Disp_BtnIncClick();
        break;
    case BUTTON_ID_TWDec:
        Disp_BtnDecClick();
        break;
    case BUTTON_ID_SInc:
        Disp_BtnSpeedIncClick();
        break;
    case BUTTON_ID_SDec:
        Disp_BtnSpeedDecClick();
        break;
    }
}

void Disp_CreateButtons(void )
{
    BUTTON btnInfo;

    btnInfo.cb4c      = Disp_BtnClicked;//Disp_BtnCirClick
    btnInfo.cb4lc     = NULL;
    
    btnInfo.bmpNormal = bmptakewater;  //bmpcir
    btnInfo.bmpActive = bmpbtnclick;  //bmpcir
    btnInfo.usHeight  = SHOW_BUTTON_DIAMETER;
    btnInfo.usWidth   = SHOW_BUTTON_DIAMETER;
    btnInfo.usLeft    = SHOW_BUTTON_CIR_CX + btnInfo.usWidth/5;//////
    btnInfo.usTop     = SHOW_BUTTON_CIR_CY - btnInfo.usHeight / 2;
    btnInfo.ucBtnType = BUTTON_TYPE_BITMAP;
    btnInfo.szName    = NULL;
    btnInfo.tag       = (void *)BUTTON_ID_TW;
    //gpBtnTw           = BtnCreateButton(&btnInfo);

    btnInfo.bmpNormal = bmpcirculate;  //bmpcir
    btnInfo.bmpActive = bmpbtnclick;  //bmpcir
    btnInfo.usHeight  = SHOW_BUTTON_DIAMETER;
    btnInfo.usWidth   = SHOW_BUTTON_DIAMETER;
    btnInfo.usLeft    = 2;//SHOW_BUTTON_TW_CX - btnInfo.usWidth/3*4;
    btnInfo.usTop     = MAKE_BOTTOM_CORD(SHOW_WARNING_CY,SHOW_WARNING_CH) +2;//SHOW_BUTTON_TW_CY - btnInfo.usHeight / 2;
    btnInfo.tag       = (void *)BUTTON_ID_CIR;
    gpBtnCir          = BtnCreateButton(&btnInfo);

    btnInfo.cb4c      = Disp_BtnClicked;
    btnInfo.cb4lc     = Disp_BtnClicked;
    btnInfo.bmpNormal = bmpTWInc;  
    btnInfo.bmpActive = bmpbtnclick;  
    btnInfo.usHeight  = SHOW_BUTTON_DIAMETER;
    btnInfo.usWidth   = SHOW_BUTTON_DIAMETER;
    btnInfo.usLeft    = SHOW_BUTTON_TWInc_CX;///////
    btnInfo.usTop     = SHOW_BUTTON_TWInc_CY - btnInfo.usHeight / 5*2;
    btnInfo.tag       = (void *)BUTTON_ID_TWInc;
    gpBtnTWInc        = BtnCreateButton(&btnInfo);
    
    btnInfo.cb4c      = Disp_BtnClicked;
    btnInfo.cb4lc     = Disp_BtnClicked;
    btnInfo.usHeight  = SHOW_BUTTON_DIAMETER;
    btnInfo.usWidth   = SHOW_BUTTON_DIAMETER;
    btnInfo.usLeft    = SHOW_BUTTON_TWDec_CX - btnInfo.usWidth + 3;//////
    btnInfo.usTop     = SHOW_BUTTON_TWDec_CY - btnInfo.usHeight / 5*2;
    btnInfo.bmpNormal = bmpTWDec;  
    btnInfo.bmpActive = bmpbtnclick;  
    btnInfo.tag       = (void *)BUTTON_ID_TWDec;
    gpBtnTWDec        = BtnCreateButton(&btnInfo);

    btnInfo.cb4c      = Disp_BtnClicked;//Disp_BtnCirClick
    btnInfo.cb4lc     = NULL;
    btnInfo.bmpNormal = bmpSpeedInc;  //bmpcir
    btnInfo.bmpActive = bmpbtnclick;  //bmpcir
    btnInfo.usHeight  = SHOW_BUTTON_DIAMETER;
    btnInfo.usWidth   = SHOW_BUTTON_DIAMETER;
    btnInfo.usLeft    = SHOW_BUTTON_SInc_CX - btnInfo.usWidth / 5*2;
    btnInfo.usTop     = SHOW_BUTTON_SInc_CY - btnInfo.usHeight / 2;
    btnInfo.tag       = (void *)BUTTON_ID_SInc;
    gpBtnSpeedInc     = BtnCreateButton(&btnInfo);

    btnInfo.cb4c      = Disp_BtnClicked;//Disp_BtnCirClick
    btnInfo.cb4lc     = NULL;
    btnInfo.bmpNormal = bmpSpeedDec;  //bmpcir
    btnInfo.bmpActive = bmpbtnclick;  //bmpcir
    btnInfo.usHeight  = SHOW_BUTTON_DIAMETER;
    btnInfo.usWidth   = SHOW_BUTTON_DIAMETER;
    btnInfo.usLeft    = SHOW_BUTTON_SDec_CX - btnInfo.usWidth / 5*2;
    btnInfo.usTop     = SHOW_BUTTON_SDec_CY - btnInfo.usHeight / 5*2;
    btnInfo.tag       = (void *)BUTTON_ID_SDec;
    gpBtnSpeedDec     = BtnCreateButton(&btnInfo);
    

}

// End BLE_VERSION

void Disp_Init(void)
{
    BtnInit();    

    memset(&gDisplay,0,sizeof(DISPLAY_STRU));

    Disp_ReadConfig();

    // global initialization
    gDisplay.usForColor        = GRAY;//BLACK;
    gDisplay.usBackColor       = WHITE;
    gDisplay.usBackColor4Set   = WHITE;
    gDisplay.usBackColor4ScreenSaver   = BLACK;  //GBLUE;
	gDisplay.bit1ScreenSaver = FALSE;
	
    gDisplay.cfg->cfg1.devType = APP_DEV_HS_SUB_HYPER; // late update from cfg
    gDisplay.ucDspWelcomeTime  = 1; // fixed to three second
    gDisplay.ulStartSecond     = RTC_Get_Second();

    gDisplay.curPage.ucMain    = DISPLAY_PAGE_BUTT;
    gDisplay.curPage.ucSub     = DISPLAY_SUB_PAGE_BUTT;

    gDisplay.usPulseNum        = 450;

    gDisplay.fWaterQuality     = 0;
    gDisplay.iTemperature      = 0;
    gDisplay.fWaterPPB         = 0;

    gDisplay.ucTwType          = APP_DEV_HS_SUB_NUM;

    gDisplay.bit1InvalidScreen = TRUE;

    oldfont = NULL;
		
    // init default fount
    font24.DrawChar    = LCD_PutChar12x24;
    font24.DrawText    = LCD_PutStringGB24x24;
    font24.GetTextSize = LCD_GetStringGB24x24TextSize;
    font24.sizeX = 12;
    font24.sizeY = 24;

    font8.DrawChar = LCD_PutChar8x16;
    font8.DrawText = LCD_PutStringGB16x16;
    font8.GetTextSize = LCD_GetStringGB8x16TextSize;
    font8.sizeX = 8;
    font8.sizeY = 16;

#ifdef CODEGB_32
    font32.DrawChar = NULL;
    font32.DrawText = PutStringGB3232;
    font32.GetTextSize = LCD_GetStringGB32x32TextSize;
    font32.sizeX = 16;
    font32.sizeY = 32;
#endif

#ifdef CODEGB_48
    font48.DrawChar = NULL;
    font48.DrawText = PutStringGB4848;
    font48.GetTextSize = LCD_GetStringGB48x48TextSize;
    font48.sizeX = 24;
    font48.sizeY = 48;
#endif

    Disp_SelectFont(&font24); // font24 as default font   

    {
        int xoff;

        sprintf((char *)Config_buff,TIME_FORMAT_SHORT,0,0,0,0,0);
        xoff = curFont->sizeX*strlen((char *)Config_buff);

        rectTime.left     = LCD_W - TIME_RECT_MARGIN*2 - xoff;
        rectTime.right    = rectTime.left + xoff + TIME_RECT_MARGIN*2 ;
        rectTime.top      = TIME_RECT_MARGIN ;
        rectTime.bottom   = rectTime.top + curFont->sizeY + TIME_RECT_MARGIN*2;
    }

    Disp_ReadQtwVolume();

    Disp_ValveCtrl(&gDisplay.CurState);

    Disp_CreateButtons();

    //Calculation_SpeedArc_Point(SHOW_ARC_X,SHOW_ARC_Y,SHOW_ARC_R);
    
    // Disp_DisplayIdlePage();
    Disp_DisplayWelcomePage();
    
}

